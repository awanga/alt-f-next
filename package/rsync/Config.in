## package/rsync/Config.in
```kconfig
config BR2_PACKAGE_RSYNC
	bool "rsync"
	help
	  File transfer program to keep remote files in sync.

	  http://rsync.samba.org/

config BR2_PACKAGE_RSYNC_ACL
	bool "rsync-acl"
	depends on BR2_PACKAGE_RSYNC
	select BR2_PACKAGE_ACL
	help
	  compile rsync with ACL an XATTR support
```

## package/sabnzbd/Config.in
```kconfig
config BR2_PACKAGE_SABNZBD
	bool "sabnzbd"
	select BR2_PACKAGE_PYTHON
	select BR2_PACKAGE_CHEETAH
	select BR2_PACKAGE_PYOPENSSL
	select BR2_PACKAGE_YENC
	help
	   SABnzbd is an Open Source Binary Newsreader written in Python. (dummy package)

	   http://sabnzbd.org/
```

## package/samba-small/Config.in
```kconfig
comment "samba-small needs a toolchain w/ RPC, wchar, dynamic library, NPTL"
	depends on BR2_TOOLCHAIN_HAS_SYNC_4
	depends on !BR2_USE_WCHAR \
		|| BR2_STATIC_LIBS || !BR2_TOOLCHAIN_HAS_THREADS_NPTL
	depends on BR2_USE_MMU

config BR2_PACKAGE_SAMBA_SMALL
	bool "samba-small"
	depends on ! BR2_PACKAGE_SAMBA4
	depends on BR2_USE_MMU # fork()
	depends on BR2_USE_WCHAR # python
	#depends on BR2_TOOLCHAIN_HAS_NATIVE_RPC
	depends on BR2_TOOLCHAIN_HAS_THREADS_NPTL # python -> libffi
	depends on !BR2_STATIC_LIBS # python, gnutls
	depends on !BR2_nios2 # binary too large, relocations don't fit
	depends on BR2_TOOLCHAIN_HAS_SYNC_4
	select BR2_PACKAGE_E2FSPROGS
	select BR2_PACKAGE_POPT
	select BR2_PACKAGE_PYTHON
	select BR2_PACKAGE_ZLIB
	help
	  Provides secure, stable and fast file and print services
	  for all clients using the SMB/CIFS protocol, such as all
	  versions of DOS, Windows, OS/2, Linux and many others.

	  http://www.samba.org/
```

## package/samba/Config.in
```kconfig
config BR2_PACKAGE_SAMBA
	bool "samba"
	select BR2_PACKAGE_LIBICONV
	select BR2_PACKAGE_POPT
	select BR2_PACKAGE_ACL if !BR2_PACKAGE_SAMBA_SMALL
	help
	  Provides file an print services to all manner of SMB/CIFS clients,
	  including the numerous versions of MS-Windows operating systems.

	  http://www.samba.org/

config BR2_PACKAGE_SAMBA_OPTIM
	string "samba optim"
	depends on BR2_PACKAGE_SAMBA
	help
	  Additional compile options (-Os, -O2)

config BR2_PACKAGE_SAMBA_SMALL
	bool "small"
	default n
	depends on BR2_PACKAGE_SAMBA
	help
	  Minimum base Samba

config BR2_PACKAGE_SAMBA_DOC
	bool "doc"
	default n
	depends on BR2_PACKAGE_SAMBA
	depends on !BR2_PACKAGE_SAMBA_SMALL
	help
	  Samba Web Administration Tool online help

config BR2_PACKAGE_SAMBA_MODULES
	bool "modules"
	default n
	depends on BR2_PACKAGE_SAMBA
	depends on !BR2_PACKAGE_SAMBA_SMALL
	help
	  Samba VFS modules

config BR2_PACKAGE_SAMBA_EXTRA
	bool "extra"
	default n
	depends on BR2_PACKAGE_SAMBA
	depends on !BR2_PACKAGE_SAMBA_SMALL
	help
	  Extra Samba binaries
```

## package/samba36/Config.in
```kconfig
config BR2_PACKAGE_SAMBA36
	bool "samba36"
	select BR2_PACKAGE_LIBICONV
	select BR2_PACKAGE_POPT
	select BR2_PACKAGE_ACL if !BR2_PACKAGE_SAMBA36_SMALL
	help
	  Provides file an print services to all manner of SMB/CIFS clients,
	  including the numerous versions of MS-Windows operating systems.

	  http://www.samba.org/

config BR2_PACKAGE_SAMBA36_OPTIM
	string "samba36 optim"
	depends on BR2_PACKAGE_SAMBA36
	help
	  Additional compile options (-Os, -O2)

config BR2_PACKAGE_SAMBA36_SMALL
	bool "small"
	default n
	depends on BR2_PACKAGE_SAMBA36
	help
	  Minimum base Samba

config BR2_PACKAGE_SAMBA36_DOC
	bool "doc"
	default n
	depends on BR2_PACKAGE_SAMBA36
	depends on !BR2_PACKAGE_SAMBA36_SMALL
	help
	  Samba Web Administration Tool online help

config BR2_PACKAGE_SAMBA36_MODULES
	bool "modules"
	default n
	depends on BR2_PACKAGE_SAMBA36
	depends on !BR2_PACKAGE_SAMBA36_SMALL
	help
	  Samba VFS modules

config BR2_PACKAGE_SAMBA36_EXTRA
	bool "extra"
	default n
	depends on BR2_PACKAGE_SAMBA36
	depends on !BR2_PACKAGE_SAMBA36_SMALL
	help
	  Extra Samba binaries
```

## package/sane/Config.in
```kconfig
config BR2_PACKAGE_SANE
	bool "sane"
	select BR2_PACKAGE_LIBUSB
	select BR2_PACKAGE_TIFF
	select BR2_PACKAGE_JPEG
	help
	  SANE stands for Scanner Access Now Easy.

	  http://www.sane-project.org/
```

## package/secure-delete/Config.in
```kconfig
config BR2_PACKAGE_SECURE_DELETE
	bool "secure-delete"
	help
	  tools to wipe files, free disk space, swap and memory

	  https://packages.debian.org/source/sid/secure-delete
```

## package/serf/Config.in
```kconfig
config BR2_PACKAGE_SERF
	bool "serf"
	help
	  A high performance C-based HTTP client library 

	  http://code.google.com/p/serf
```

## package/sg3_utils/Config.in
```kconfig
config BR2_PACKAGE_SG3_UTILS
	bool "sg3_utils"
	help
	  SCSI utilities

	  http://sg.danny.cz/sg/p
```

## package/shellinabox/Config.in
```kconfig
config BR2_PACKAGE_SHELLINABOX
	bool "shellinabox"
	select BR2_PACKAGE_OPENSSL

	help
	  a web based terminal emulator

	  https://github.com/shellinabox/shellinabox
```

## package/sickbeard/Config.in
```kconfig
config BR2_PACKAGE_SICKBEARD
	bool "sickbeard"
	select BR2_PACKAGE_PYTHON
	select BR2_PACKAGE_CHEETAH
	select BR2_PACKAGE_PYOPENSSL
	help
	  The ultimate PVR application that searches for and manages your TV shows (dummy package)

	  http://sickbeard.com
```

## package/smartmontools/Config.in
```kconfig
comment "smartmontools has no inherent support for AVR32" 
	depends on BR2_avr32 && BR2_PACKAGE_SMARTMONTOOLS

config BR2_PACKAGE_SMARTMONTOOLS
	bool "smartmontools"
	help
	  Control and monitor storage systems using S.M.A.R.T.

	  http://smartmontools.sourceforge.net/

config BR2_PACKAGE_SMARTMONTOOLS_OPTIM
	string "smartmontools optim"
	depends on BR2_PACKAGE_SMARTMONTOOLS
	help
	  Compile optimization options (-Os, -O2)
```

## package/squashfs/Config.in
```kconfig
config BR2_PACKAGE_SQUASHFS
	bool "squashfs"
	help
	  Squashfs is a highly compressed read-only filesystem for Linux.

	  http://sourceforge.net/squashfs

config BR2_PACKAGE_SQUASHFS_HOST
	bool "Install squashfs for the host/build system"
	depends on BR2_PACKAGE_SQUASHFS
	select BR2_PACKAGE_XZ_HOST
	help
	  squashfs utils on the host

config BR2_PACKAGE_SQUASHFS_TARGET
	bool "Install squashfs for the target"
	depends on BR2_PACKAGE_SQUASHFS
	select BR2_PACKAGE_XZ_TARGET
	help
	  squashfs utils on the target
```

## package/srm/Config.in
```kconfig
config BR2_PACKAGE_SRM
	bool "srm"
	help
	  command-line program to delete files securely

	  https://sourceforge.net/projects/srm
```

## package/svn/Config.in
```kconfig
config BR2_PACKAGE_SVN
	bool "svn"
	select BR2_PACKAGE_APR
	select BR2_PACKAGE_APR_UTIL
	select BR2_PACKAGE_NEON
	select BR2_PACKAGE_NEON_ZLIB
	help
	  Enterprise-class centralized version control for the masses

	  http://subversion.apache.org
```

## package/syncthing/Config.in
```kconfig
config BR2_PACKAGE_SYNCTHING
	bool "syncthing"
	help
	  Open Source Continuous File Synchronization

	  https://github.com/syncthing
```

## package/sysstat/Config.in
```kconfig
config BR2_PACKAGE_SYSSTAT
	bool "sysstat"
	help
	  The sysstat utilities are a collection of performance monitoring tools for Linux

	  http://sebastien.godard.pagesperso-orange.fr/index.html
```

## package/tar/Config.in
```kconfig
config BR2_PACKAGE_TAR
	bool "tar"
	select BR2_PACKAGE_ACL
	select BR2_PACKAGE_LIBICONV
	select BR2_PACKAGE_GZIP
	select BR2_PACKAGE_BZIP2
	depends on BR2_USE_WCHAR && BR2_PROGRAM_INVOCATION
	help
	  A program that saves many files together into a single tape or disk
	  archive, and can restore individual files from the archive.

	  http://www.gnu.org/software/tar/

comment "tar requires a toolchain with WCHAR and PROGRAM_INVOCATION support"
	depends on !(BR2_USE_WCHAR && BR2_PROGRAM_INVOCATION)
```

## package/tcsh/Config.in
```kconfig
config BR2_PACKAGE_TCSH
	bool "tcsh"
	select BR2_PACKAGE_NCURSES
	help
	  Tcsh is an enhanced, but completely compatible version of the Berkeley UNIX C shell (csh).

	  http://www.tcsh.org/Welcome
```

## package/texinfo/Config.in
```kconfig
config BR2_PACKAGE_TEXINFO_HOST
	bool "Install texinfo-4.13a for the host/build system"
	default y
	help
	  the official documentation format of the GNU project

	  http://savannah.gnu.org/projects/texinfo
```

## package/transmission/Config.in
```kconfig
config BR2_PACKAGE_TRANSMISSION
	bool "transmission"
	select BR2_PACKAGE_LIBCURL
	select BR2_PACKAGE_OPENSSL
	select BR2_PACKAGE_LIBEVENT2
	help
	  Bittorrent client

	  http://download.m0k.org/transmission/files
```

## package/tt-rss/Config.in
```kconfig
config BR2_PACKAGE_TT_RSS
	bool "tt-rss"
	select BR2_PACKAGE_PHP
	select BR2_PACKAGE_LIGHTTPD
	select BR2_PACKAGE_MYSQL_SERVER
	help
	  A web-based news feed (RSS/Atom) reader and aggregator

	  http://tt-rss.org
```

## package/uboot-envtools/Config.in
```kconfig
config BR2_PACKAGE_UBOOT_ENVTOOLS
	bool "uboot-envtools"
	help
	  read and write U-Boot environment variables from flash memory

	  http://ftp.de.debian.org/debian/pool/main/u/uboot-envtools
```

## package/uboot-mkimage/Config.in
```kconfig
config BR2_PACKAGE_UBOOT_MKIMAGE_HOST
	bool "uboot-mkimage"
	help
	  host utility to generate kernel image for U-Boot

	  http://ftp.de.debian.org/debian/pool/main/u/uboot-mkimage
```

## package/uni2ascii/Config.in
```kconfig
config BR2_PACKAGE_UNI2ASCII
	bool "uni2ascii"
	help
	  convert UTF-8 Unicode to various 7-bit ASCII representations and vice-versa

	 http://billposer.org/Software/uni2ascii.html
```
