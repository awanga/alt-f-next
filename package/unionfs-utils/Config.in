## package/unionfs-utils/Config.in
```kconfig
config BR2_PACKAGE_UNIONFS_UTILS
	bool "unionfs_utils"
	help
	  Unionfs utilities

	  http://www.fsl.cs.sunysb.edu/project-unionfs.html
```

## package/unrar/Config.in
```kconfig
config BR2_PACKAGE_UNRAR
	bool "unrar"
	help
	  Provides unrar decompressor

	  http://www.rarlab.com/rar_add.htm
```

## package/vsftpd/Config.in
```kconfig
config BR2_PACKAGE_VSFTPD
	bool "vsftpd"
	help
	  vsftpd is an ftp daemon written with security in mind.
	  http://vsftpd.beasts.org/

config BR2_PACKAGE_VSFTPD_OPTIM
	string "vsftpd optim"
	depends on BR2_PACKAGE_VSFTPD
	help
	  Compile optimization options (-Os, -O2)
```

## package/wget/Config.in
```kconfig
config BR2_PACKAGE_WGET
	bool "wget"
	help
	  Network utility to retrieve files from http/ftp/etc...

	  http://wget.sunsite.dk/
	  
config BR2_PACKAGE_WGET_OPTIM
	string "wget optim"
	depends on BR2_PACKAGE_WGET
	help
	  Compile optimization options (-Os, -O2)
```

## package/wsdd2/Config.in
```kconfig
config BR2_PACKAGE_WSDD2
	bool "wsdd2"
	help
	WSD/LLMNR Discovery/Name Service Daemon
	With Microsoft turning off SMB1 feature completely on Windwos 10, any Samba shares on the local network become invisible to Windwos 10 computers. That's due to the fact that SMB1 is required for Computer Browser service to function.
	 
	 https://github.com/Andy2244/wsdd2
```

## package/wxwidgets/Config.in
```kconfig
config BR2_PACKAGE_WXWIDGETS
	bool "wxwidgets"
	help
	  single, easy-to-use API/Framework for writing applications on multiple platforms and languages 

	  http://www.wxwidgets.org
```

## package/xz/Config.in
```kconfig
config BR2_PACKAGE_XZ
	bool "xz"
	help
	  XZ Utils provide a general-purpose data-compression library plus command-line tools.

	  http://tukaani.org/xz/

config BR2_PACKAGE_XZ_HOST
	bool "xz-host"
	depends on BR2_PACKAGE_XZ
	help
	  Install xz/lzma utils on the host/build system

config BR2_PACKAGE_XZ_LIBS
	bool "xz-libs"
	depends on BR2_PACKAGE_XZ
	help
	  install xz/lzma libraries on the target

config BR2_PACKAGE_XZ_PROGS
	bool "xz-progs"
	depends on BR2_PACKAGE_XZ_LIBS
	help
	  install xz/lzma utils on the target
```

## package/yenc/Config.in
```kconfig
config BR2_PACKAGE_YENC
	bool "yenc"
	select BR2_PACKAGE_PYTHON
	help
	  Python module providing raw yEnc encoding/decoding with built-in crc32 calculation

	  http://www.golug.it/yenc.html
```
