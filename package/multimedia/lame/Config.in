## package/multimedia/lame/Config.in
```kconfig
config BR2_PACKAGE_LAME
	bool "lame"
	help
	  LAME Ain't an Mp3 Encoder. LAME is an educational tool to be used for learning about MP3 encoding.
	
	  http://lame.sourceforge.net
```

## package/multimedia/libdlna/Config.in
```kconfig
config BR2_PACKAGE_LIBDLNA
	bool "libdlna"
	select BR2_PACKAGE_FFMPEG
	help
	  DLNA Library (mostly for uShare)

	  http://libdlna.geexbox.org/
```

## package/multimedia/libvorbis/Config.in
```kconfig
config BR2_PACKAGE_LIBVORBIS
	bool "libvorbis"
	select BR2_PACKAGE_LIBOGG
	help
	  Library for the Vorbis open source audio decoder

	  http://xiph.org/vorbis/

config BR2_PACKAGE_LIBVORBIS_TREMOR
	bool "use fixed point implementation (tremor)"
	#default y if BR2_SOFT_FLOAT
	depends on BR2_PACKAGE_LIBVORBIS
	help
	  Use the Tremor fixed point implementation
```

## package/multimedia/logitechmediaserver/Config.in
```kconfig
config BR2_PACKAGE_LOGITECHMEDIASERVER
	bool "logitechmediaserver"
	select BR2_PACKAGE_PERL
	select BR2_PACKAGE_ICU
	select BR2_PACKAGE_SOX
	select BR2_PACKAGE_SHINE
	help
	  a streaming audio server supported by Logitech (formerly Slim Devices), developed in particular to support their Squeezebox range of digital audio receivers.

	  http://www.mysqueezebox.com/download
```

## package/multimedia/mediatomb/Config.in
```kconfig
config BR2_PACKAGE_MEDIATOMB
	bool "mediatomb"
	select BR2_PACKAGE_LIBCURL
	select BR2_PACKAGE_SQLITE
	select BR2_PACKAGE_MYSQL
	select BR2_PACKAGE_EXPAT
	select BR2_PACKAGE_FILE
	select BR2_PACKAGE_TAGLIB
	select BR2_PACKAGE_FFMPEG
	help
	  UPnP MediaServer

	  http://mediatomb.cc
```

## package/multimedia/minidlna/Config.in
```kconfig
config BR2_PACKAGE_MINIDLNA
	bool "minidlna"
	select BR2_PACKAGE_LIBEXIF
	select BR2_PACKAGE_JPEG
	select BR2_PACKAGE_LIBID3TAG
	select BR2_PACKAGE_FLAC
	select BR2_PACKAGE_LIBVORBIS
	select BR2_PACKAGE_SQLITE
	select BR2_PACKAGE_FFMPEG
	help
	  minidlna is a media server compliant with DLNA/UPnP-AV clients

	  http://sourceforge.net/projects/minidlna
```

## package/multimedia/mp3gain/Config.in
```kconfig
config BR2_PACKAGE_MP3GAIN
	bool "mp3gain"
	help
	  MP3Gain analyzes and adjusts mp3 files so that they have the same volume

	  http://mp3gain.sourceforge.net
```

## package/multimedia/mpd/Config.in
```kconfig
config BR2_PACKAGE_MPD
	bool "mpd"
	select BR2_PACKAGE_LIBCURL
	select BR2_PACKAGE_SQLITE
	select BR2_PACKAGE_ALSA_LIB
	select BR2_PACKAGE_LIBGLIB2
	select BR2_PACKAGE_LIBID3TAG
	select BR2_PACKAGE_FLAC
	select BR2_PACKAGE_LIBVORBIS
	select BR2_PACKAGE_LIBOGG
	select BR2_PACKAGE_LIBMAD
	select BR2_PACKAGE_FFMPEG
	select BR2_PACKAGE_LAME
	select BR2_PACKAGE_TWOLAME
	select BR2_PACKAGE_MPG123
	select BR2_PACKAGE_WAVPACK
	select BR2_PACKAGE_FAAD2
	help
	  A flexible, powerful, server-side application for playing music

	  http://www.musicpd.org
```

## package/multimedia/mpg123/Config.in
```kconfig
config BR2_PACKAGE_MPG123
	bool "mpg123"
	help
	  Fast, free and portable MPEG audio player for Unix.  It supports
	  MPEG 1.0/2.0 layers 1, 2 and 3.

	  http://www.mpg123.de/

config BR2_PACKAGE_MPG123_LIBS
        default y
        bool "mpg123-libs"
        depends on BR2_PACKAGE_MPG123
        help
          install mpg123 libraries on the target

config BR2_PACKAGE_MPG123_PROGS
        depends on BR2_PACKAGE_MPG123_LIBS
        bool "mpg123-progs"
        help
          install mpg123 programs on the target
```

## package/multimedia/mt-daapd/Config.in
```kconfig
config BR2_PACKAGE_MT_DAAPD
	bool "mt-daapd"
	select BR2_PACKAGE_GDBM
	select BR2_PACKAGE_LIBID3TAG
	select BR2_PACKAGE_LIBVORBIS
	help
	 mt-daapd is Media server for the Roku SoundBridge and iTunes
	 
	 http://www.fireflymediaserver.org/
```

## package/multimedia/shine/Config.in
```kconfig
config BR2_PACKAGE_SHINE
	bool "shine"
	help
	  fast mp3 encoding library implemented in fixed-point arithmetic

	  https://github.com/savonet/shine
```

## package/multimedia/sox/Config.in
```kconfig
config BR2_PACKAGE_SOX
	bool "sox"
	select BR2_PACKAGE_LIBVORBIS       
	select BR2_PACKAGE_FLAC
	select BR2_PACKAGE_LIBMAD
	select BR2_PACKAGE_WAVPACK
	select BR2_PACKAGE_LAME
	select BR2_PACKAGE_TWOLAME
	select BR2_PACKAGE_LIBPNG
	select BR2_PACKAGE_LIBID3TAG
	select BR2_PACKAGE_ALSA_LIB
	help
	  the Swiss Army knife of sound processing programs

	  http://sox.sourceforge.net/Main/HomePage

config BR2_PACKAGE_SOX_LIBS
        default y
        bool "sox-libs"
        depends on BR2_PACKAGE_SOX
        help
          install sox libraries on the target

config BR2_PACKAGE_SOX_PROGS
        depends on BR2_PACKAGE_SOX_LIBS
        bool "sox-progs"
        help
          install sox programs on the target
```

## package/multimedia/twolame/Config.in
```kconfig
config BR2_PACKAGE_TWOLAME
	bool "twolame"
	help
	  An optimized MPEG Audio Layer 2 encoder

	  http://www.twolame.org
```

## package/multimedia/twonky/Config.in
```kconfig
config BR2_PACKAGE_TWONKY
	bool "twonky"
	help
	  twonky is a uPnP media server

	  http://www.twonky.com
```

## package/multimedia/ushare/Config.in
```kconfig
config BR2_PACKAGE_USHARE
	bool "ushare"
	select BR2_PACKAGE_LIBUPNP
	select BR2_PACKAGE_LIBDLNA
	help
	  uPNP AV server

	  http://ushare.geexbox.org
```

## package/multimedia/wavpack/Config.in
```kconfig
config BR2_PACKAGE_WAVPACK
	bool "wavpack"
	select BR2_PACKAGE_LIBICONV
	help
	  a completely open audio compression format providing lossless and high-quality lossy

	  http://www.wavpack.com/
 
config BR2_PACKAGE_WAVPACK_LIBS
        default y
        bool "wavepack-libs"
        depends on BR2_PACKAGE_WAVPACK
        help
          install wavepack libraries on the target

config BR2_PACKAGE_WAVPACK_PROGS
        depends on BR2_PACKAGE_WAVPACK_LIBS
        bool "wavepack-progs"
        help
          install wavepack programs on the target
```

## package/mxml/Config.in
```kconfig
config BR2_PACKAGE_MXML
	bool "mxml"
	help
	  Mini-XML is a small XML library that you can use to read and write XML and XML-like data files in your application

	  http://www.minixml.org
```

## package/netatalk/Config.in
```kconfig
config BR2_PACKAGE_NETATALK
	bool "netatalk"
	select BR2_PACKAGE_ACL
	select BR2_PACKAGE_DB
	select BR2_PACKAGE_LIBGCRYPT
	select BR2_PACKAGE_LIBEVENT2
	select BR2_PACKAGE_AVAHI
	select BR2_PACKAGE_AVAHI_LIBCLIENT
	select BR2_PACKAGE_AVAHI_DAEMON
	help
	 A AFP (Apple Filling Protocol) fileserver

	  http://netatalk.sourceforge.net/
```

## package/netatalk2/Config.in
```kconfig
config BR2_PACKAGE_NETATALK2
	bool "netatalk2"
	select BR2_PACKAGE_DB
	select BR2_PACKAGE_LIBGCRYPT
	select BR2_PACKAGE_AVAHI
	help
	 Apple Filling Protocol, netatalk version 2.2

	  http://netatalk.sourceforge.net/
```

## package/netkit-rsh/Config.in
```kconfig
config BR2_PACKAGE_NETKIT_RSH
	bool "netkit-rsh"
	help
	  programs for remote shell connections

	  http://ftp.de.debian.org/debian/pool/main/n/netkit-rsh/netkit-rsh_0.17.orig.tar.gz
```

## package/netperf/Config.in
```kconfig
config BR2_PACKAGE_NETPERF
	bool "netperf"
	help
	  Netperf is a benchmark that can be used to measure the performance of many different types of networking.

	  http://www.netperf.org/netperf/
```

## package/nmap/Config.in
```kconfig
config BR2_PACKAGE_NMAP
	bool "nmap"
	select BR2_PACKAGE_PCRE
	help
	  Nmap is a free and open source utility for network exploration or security auditing.

	  http://nmap.org
```

## package/ntfs-3g/Config.in
```kconfig
config BR2_PACKAGE_NTFS_3G
	bool "ntfs-3g"
	depends on BR2_LARGEFILE
	depends on BR2_USE_WCHAR
	help
	 NTFS-3G is a stable, full-featured, read-write NTFS driver for Linux, Android, Mac OS X,
	 FreeBSD, NetBSD, OpenSolaris, QNX, Haiku, and other operating systems. It provides safe
	 handling of the Windows XP, Windows Server 2003, Windows 2000, Windows Vista,
	 Windows Server 2008 and Windows 7 NTFS file systems. ntfsprogs is now merged in ntfs-3g.

	  http://www.tuxera.com/community/ntfs-3g-download/

#comment "ntfs-3g requires a toolchain with LARGEFILE and WCHAR support"
#	depends on !(BR2_LARGEFILE && BR2_USE_WCHAR)

config BR2_PACKAGE_NTFS_3G_NTFSPROGS
	bool "ntfsprogs"
	depends on BR2_PACKAGE_NTFS_3G
	help
	  Compile also the ntfsprogs utilities programs
```

## package/ntfsprogs/Config.in
```kconfig
config BR2_PACKAGE_NTFSPROGS
	bool "ntfsprogs"
	depends on BR2_USE_WCHAR
	help
	  wide collection of NTFS utilities. ntfsmount needs libfuse

	  http://www.linux-ntfs.org/

config BR2_PACKAGE_NTFSPROGS_NTFSMOUNT
	bool "ntfsmount"
	depends on BR2_PACKAGE_NTFSPROGS
	select BR2_PACKAGE_LIBFUSE
	help
	  Mounts a ntfs partition. See also the ntfs-3g package
	  
comment "ntfsprogs requires a toolchain with WCHAR support"
	depends on !BR2_USE_WCHAR
```

## package/ntp-common/Config.in
```kconfig
config BR2_PACKAGE_NTP_COMMON
	bool "ntp-common"
	help
	  Support files for ntpd and busybox ntpd
```
