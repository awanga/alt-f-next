## package/libgd/Config.in
```kconfig
config BR2_PACKAGE_LIBGD
	bool "libgd"
	select BR2_PACKAGE_JPEG
	select BR2_PACKAGE_LIBPNG
	help
	  A graphics library for fast image creation.

	  https://bitbucket.org/pierrejoye/gd-libgd/
```

## package/libgpg-error/Config.in
```kconfig
config BR2_PACKAGE_LIBGPG_ERROR
	bool "libgpg-error"
	help
	  Libgpg-error is a small library with error codes and
	  descriptions shared by most GnuPG related software.

	  https://www.gnupg.org/software/libgpg-error/index.html
```

## package/libiconv/Config.in
```kconfig
config BR2_PACKAGE_LIBICONV
	bool "libiconv"
	help
	  unicode conversion library

	  http://ftp.gnu.org/pub/gnu/libiconv

config BR2_PACKAGE_LIBICONV_OPTIM
	string "libiconv optim"
	depends on BR2_PACKAGE_LIBICONV
	help
	  Compile optimization options (-Os, -O2)
```

## package/libmcrypt/Config.in
```kconfig
config BR2_PACKAGE_LIBMCRYPT
	bool "libmcrypt"
	help
	  Replacements for the old Unix crypt, under the GPL and support an ever-wider range of algorithms and modes.

	  http://sourceforge.net/projects/mcrypt
```

## package/libnl/Config.in
```kconfig
config BR2_PACKAGE_LIBNL
	bool "libnl"
	help
	  A library for applications dealing with netlink socket.

	  https://www.infradead.org/~tgr/libnl/files
```

## package/libpar2/Config.in
```kconfig
config BR2_PACKAGE_LIBPAR2
	bool "libpar2"
	select BR2_PACKAGE_LIBSIGCPP
	help
	  Parity Archive Volume recovery of multi-part archives on Usenet

	  http://parchive.sourceforge.net
```

## package/librsync/Config.in
```kconfig
 config BR2_PACKAGE_LIBRSYNC
	bool "librsync"
	help
	  librsync implements the rolling-checksum algorithm of remote file synchronization that was popularized by the rsync utility.
	  This algorithm transfers the differences between 2 files without needing both files on the same system.

	  http://sourceforge.net/projects/librsync
```

## package/libsigcpp/Config.in
```kconfig
config BR2_PACKAGE_LIBSIGCPP
	bool "libsigcpp"
	help
	  libsigc++ implements a typesafe callback system for standard C++

	  http://libsigc.sourceforge.net/
```

## package/libsodium/Config.in
```kconfig
config BR2_PACKAGE_LIBSODIUM
	bool "libsodium"
	help
	  library for encryption, decryption, signatures, password hashing and more

	  https://download.libsodium.org/doc/
```

## package/libunistring/Config.in
```kconfig
config BR2_PACKAGE_LIBUNISTRING
	bool "libunistring"
	help
	  This library implements Unicode strings, together with functions for Unicode charactets and functions for string processing.

	  http://savannah.gnu.org/projects/libunistring
```

## package/libusb1/Config.in
```kconfig
config BR2_PACKAGE_LIBUSB1
	bool "libusb1"
	help
	  Userspace library for accessing USB devices

	  http://libusb.sourceforge.net/
```

## package/lxml/Config.in
```kconfig
config BR2_PACKAGE_LXML
	bool "lxml"
	select BR2_PACKAGE_PYTHON
	select BR2_PACKAGE_LIBXML2
	select BR2_PACKAGE_LIBXSLT
	select BR2_PACKAGE_ZLIB
	help
	  library for processing XML and HTML in Python

	  http://lxml.de
```

## package/mc/Config.in
```kconfig
config BR2_PACKAGE_MC
	bool "mc"
	select BR2_PACKAGE_LIBGLIB2
	select BR2_PACKAGE_SLANG
	help
	  Midnight Commander is a text-mode file manager.

	  http://www.midnight-commander.org
```

## package/mdadm/Config.in
```kconfig
config BR2_PACKAGE_MDADM
	bool "mdadm"
	help
	  Utility for managing RAID hardware.

	  http://kernel.org/pub/linux/utils/raid/mdadm
```

## package/miniupnpc/Config.in
```kconfig
config BR2_PACKAGE_MINIUPNPC
	bool "miniupnpc"
	help
	  miniupnpc library test client. The MiniUPnP project offers software which supports the UPnP Internet Gateway Device (IGD) specifications.

	  http://miniupnp.free.fr/
```

## package/mklibs/Config.in
```kconfig
config BR2_PACKAGE_MKLIBS_HOST
	bool "mklibs"
	help
	  Shared library reduction script (for the host).
	  mklibs produces cut-down shared libraries that contain only the
	  routines required by a particular set of executables.  This is
	  useful when building closed systems where disk space is at a premium,
	  such as the Debian installer.

	  http://snapshot.debian.org/archive/debian/20101225T025119Z/pool/main/m/mklibs
```

## package/msmtp/Config.in
```kconfig
config BR2_PACKAGE_MSMTP
	bool "msmtp"
	select BR2_PACKAGE_OPENSSL
	help
		msmtp is an SMTP client.
		In the default mode, it transmits a mail to an SMTP server (for
		example at a free mail provider) which does the delivery.
		To use this program with your mail user agent (MUA), create a
		configuration file with your mail account(s) and tell your MUA to 
		call msmtp instead of /usr/sbin/sendmail. 

		http://msmtp.sourceforge.net
```

## package/mtd-utils/Config.in
```kconfig
config BR2_PACKAGE_MTD_UTILS
	bool "mtd/jffs2 utilities"
	select BR2_PACKAGE_ZLIB
	select BR2_PACKAGE_LZO
	select BR2_PACKAGE_LIBUUID
	help
	  Build mtd/jffs/ubi/ubifs utilities
```

## package/multimedia/Config.in
```kconfig
menu "Audio and video libraries and applications"
source "package/multimedia/alsa-lib/Config.in"
source "package/multimedia/alsa-utils/Config.in"
source "package/multimedia/asterisk/Config.in"
source "package/multimedia/aumix/Config.in"
source "package/multimedia/faad2/Config.in"
source "package/multimedia/festival/Config.in"
source "package/multimedia/ffmpeg/Config.in"
source "package/multimedia/ffmpegthumbnailer/Config.in"
source "package/multimedia/flac/Config.in"
source "package/multimedia/forked-daapd/Config.in"
source "package/multimedia/fuppes/Config.in"
source "package/multimedia/gstreamer/Config.in"
source "package/multimedia/gst-plugins-base/Config.in"
source "package/multimedia/gst-plugins-good/Config.in"
source "package/multimedia/gst-plugins-bad/Config.in"
source "package/multimedia/gst-plugins-ugly/Config.in"
source "package/multimedia/lame/Config.in"
source "package/multimedia/libdlna/Config.in"
source "package/multimedia/libid3tag/Config.in"
source "package/multimedia/libmad/Config.in"
source "package/multimedia/libmms/Config.in"
source "package/multimedia/libmpd/Config.in"
source "package/multimedia/libogg/Config.in"
source "package/multimedia/libsndfile/Config.in"
source "package/multimedia/libtheora/Config.in"
source "package/multimedia/libvorbis/Config.in"
source "package/multimedia/logitechmediaserver/Config.in"
source "package/multimedia/madplay/Config.in"
source "package/multimedia/mediatomb/Config.in"
source "package/multimedia/minidlna/Config.in"
source "package/multimedia/mpg123/Config.in"
source "package/multimedia/mp3gain/Config.in"
source "package/multimedia/mpd/Config.in"
source "package/multimedia/mplayer/Config.in"
source "package/multimedia/mt-daapd/Config.in"
source "package/multimedia/shine/Config.in"
source "package/multimedia/sox/Config.in"
source "package/multimedia/speex/Config.in"
source "package/multimedia/taglib/Config.in"
source "package/multimedia/twolame/Config.in"
source "package/multimedia/ushare/Config.in"
source "package/multimedia/vlc/Config.in"
source "package/multimedia/wavpack/Config.in"
endmenu
```

## package/multimedia/faad2/Config.in
```kconfig
config BR2_PACKAGE_FAAD2
	bool "faad2"
	help
	  an open source MPEG-4 and MPEG-2 AAC decoder

	  http://www.audiocoding.com/faad2.html

config BR2_PACKAGE_FAAD2_LIBS
        default y
        bool "faad2-libs"
        depends on BR2_PACKAGE_FAAD2
        help
          install faad2 libraries on the target

config BR2_PACKAGE_FAAD2_PROGS
        depends on BR2_PACKAGE_FAAD2_LIBS
        bool "faad2-progs"
        help
          install faad2 programs on the target
```

## package/multimedia/ffmpeg/Config.in
```kconfig
config BR2_PACKAGE_FFMPEG
	bool "ffmpeg"
	#select BR2_PACKAGE_BZIP2
	select BR2_PACKAGE_LAME
	help
	  ffmpeg is command line tool to convert multimedia files between formats
	  libavcodec is a library containing decoders and encoders for audio/video codecs.
	  libavformat is a library containing demuxers and muxers for multimedia container formats.

	  http://ffmpeg.org

config BR2_PACKAGE_FFMPEG_LIBS
	bool "ffmpeg-libs"
	default y
	depends on BR2_PACKAGE_FFMPEG
	help
	  install ffmpeg libraries on the target

config BR2_PACKAGE_FFMPEG_PROGS
	bool "ffmpeg-progs"
	depends on BR2_PACKAGE_FFMPEG_LIBS
	help
	  install ffmpeg programs on the target
```

## package/multimedia/ffmpegthumbnailer/Config.in
```kconfig
config BR2_PACKAGE_FFMPEGTHUMBNAILER
	bool "ffmpegthumbnailer"
	select BR2_PACKAGE_FFMPEG
	select BR2_PACKAGE_JPEG
	select BR2_PACKAGE_LIBPNG
	help
	  This video thumbnailer can be used to create thumbnails for your video files. The thumbnailer uses ffmpeg to decode frames from the video files, so supported videoformats depend on the configuration flags of ffmpeg.
	  
	  http://code.google.com/p/ffmpegthumbnailer/
```

## package/multimedia/flac/Config.in
```kconfig
config BR2_PACKAGE_FLAC
	bool "flac"
	select BR2_PACKAGE_LIBOGG
	help
	  FLAC is an Open Source lossless audio codec.

	  http://flac.sourceforge.net/

config BR2_PACKAGE_FLAC_LIBS
	default y
	bool "flac-libs"
	depends on BR2_PACKAGE_FLAC
	help
	  install flac libraries on the target

config BR2_PACKAGE_FLAC_PROGS
	depends on BR2_PACKAGE_FLAC_LIBS
	bool "flac-progs"
	help
	  install flac programs on the target
```

## package/multimedia/forked-daapd/Config.in
```kconfig
config BR2_PACKAGE_FORKED_DAAPD
	bool "forked-daapd"
	select BR2_PACKAGE_SQLITE
	select BR2_PACKAGE_AVAHI
	select BR2_PACKAGE_AVAHI_LIBCLIENT
	select BR2_PACKAGE_AVAHI_AUTOIPD
	select BR2_PACKAGE_AVAHI_DAEMON
	select BR2_PACKAGE_LIBUNISTRING
	select BR2_PACKAGE_LIBGCRYPT
	select BR2_PACKAGE_LIBCONFUSE
	select BR2_PACKAGE_MXML
	select BR2_PACKAGE_ALSA_LIB
	select BR2_PACKAGE_LIBANTLR
	select BR2_PACKAGE_FFMPEG
	select BR2_PACKAGE_LIBEVENT2
	#select BR2_PACKAGE_LIBAVL
	select BR2_PACKAGE_ZLIB
	#select BR2_PACKAGE_TAGLIB
	#select BR2_PACKAGE_FLAC
	help
	 forked-daapd is a DAAP and RSP media server, with support for Linux and
	 FreeBSD. It is a complete rewrite of mt-daapd (Firefly Media Server).
	 
	 https://github.com/jasonmc/forked-daapd
```

## package/multimedia/fuppes/Config.in
```kconfig
config BR2_PACKAGE_FUPPES
	bool "fuppes"
	select BR2_PACKAGE_FFMPEG
	select BR2_PACKAGE_FLAC	
	select BR2_PACKAGE_LIBMAD	
	select BR2_PACKAGE_LIBXML2
	select BR2_PACKAGE_PCRE
	select BR2_PACKAGE_SQLITE
	select BR2_PACKAGE_TAGLIB
	select BR2_PACKAGE_LAME	
	select BR2_PACKAGE_PKG_CONFIG
	select BR2_PACKAGE_FFMPEGTHUMBNAILER
	help
	  uPNP AV server

	  http://fuppes.ulrich-voelkel.de
```
