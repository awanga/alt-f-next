## package/gs/Config.in
```kconfig
config BR2_PACKAGE_GS
	bool "gs"
	select BR2_PACKAGE_CUPS
	select BR2_PACKAGE_TIFF
	select BR2_PACKAGE_JPEG
	select BR2_PACKAGE_LIBPNG
	help
	  An interpreter for the PostScript (TM) language and the Adobe Portable Document Format

	  http://pages.cs.wisc.edu/~ghost/doc/GPL/index.htm
```

## package/hddtemp/Config.in
```kconfig
config BR2_PACKAGE_HDDTEMP
	bool "hddtemp"
	help
	  hddtemp - Read disk temperature

	  http://www.guzu.net/linux/hddtemp.php
```

## package/hfsprogs/Config.in
```kconfig
config BR2_PACKAGE_HFSPROGS
	bool "hfsprogs"
	help
	  a port of Apple's mkfs and fsck tools for HFS+ filesystems.

	  https://packages.debian.org/jessie/hfsprogs
```

## package/hplip/Config.in
```kconfig
config BR2_PACKAGE_HPLIP
	bool "hplip"
	select BR2_PACKAGE_SANE
	select BR2_PACKAGE_GS
	select BR2_PACKAGE_LIBUSB
	select BR2_PACKAGE_NETSNMP
	select BR2_PACKAGE_CUPS
	select BR2_PACKAGE_JPEG
	select BR2_PACKAGE_TIFF
	select BR2_PACKAGE_LIBPNG
	help
	  HP Linux imaging and printing

	  http://hplipopensource.com/hplip-web/about.html
```

## package/htop/Config.in
```kconfig
config BR2_PACKAGE_HTOP
	bool "htop"
	select BR2_PACKAGE_NCURSES
	help
	  An interactive process viewer for Linux

	  http://htop.sourceforge.net
```

## package/inadyn-mt/Config.in
```kconfig
config BR2_PACKAGE_INADYN_MT
	depends on BR2_USE_MMU # Uses fork()
	bool "inadyn-mt"
	help
	  inadyn-mt contains some substantive bug fixes over inadyn, a Dynamic DNS client.

	  https://sourceforge.net/projects/inadyn-mt
```

## package/inadyn/Config.in
```kconfig
config BR2_PACKAGE_INADYN
	bool "inadyn"
	help
	  Dynamic DNS client for dyndns.org (in all three flavors:
	  dynamic, static, custom), freedns.afraid.org,
	  zoneedit.com, and no-ip.com

	  http://www.inatech.eu/inadyn
```

## package/ipkg-utils/Config.in
```kconfig
config BR2_PACKAGE_IPKG_UTILS_HOST
	bool "ipkg-utils"
	help
	  Scripts (for the host) for building .ipk packages for the ipkg system.

	  http://handhelds.org/moin/moin.cgi/Ipkg
```

## package/iptraf/Config.in
```kconfig
config BR2_PACKAGE_IPTRAF
	bool "iptraf"
	select BR2_PACKAGE_NCURSES
	select BR2_PACKAGE_NCURSES_PANEL
	help
	  IPTraf is a console-based network statistics utility for Linux

	  http://iptraf.seul.org/
```

## package/iscsitarget/Config.in
```kconfig
config BR2_PACKAGE_ISCSITARGET
	bool "iscsitarget"
	help
	  iSCSI Enterprise Target is for building an iSCSI storage system on Linux.

	  http://sourceforge.net/projects/iscsitarget
```

## package/jpeg/Config.in
```kconfig
config BR2_PACKAGE_JPEG
	bool "jpeg"
	help
	  The ubiquitous C library for manipulating JPEG images.

	  http://www.ijg.org/

config BR2_PACKAGE_JPEG_LIBS
	bool "jpeg-libs"
	default y
	depends on BR2_PACKAGE_JPEG
	help
	  install jpeg libraries on the target

config BR2_PACKAGE_JPEG_PROGS
	bool "jpeg-progs"
	depends on BR2_PACKAGE_JPEG_LIBS
	help
	  install jpeg programs on the target
```

## package/kernel-modules/Config.in
```kconfig
config BR2_PACKAGE_KERNEL_MODULES
	bool "kernel-modules"
	help
	  Aditional kernel modules

if BR2_PACKAGE_KERNEL_MODULES

choice
	prompt "CPU architecture"
	default BR2_PACKAGE_KERNEL_MODULES_ARMV5
	help
		Selects CPU Architecture

	config BR2_PACKAGE_KERNEL_MODULES_ARMV5
	bool "armv5: DNS-320/320L/321/323/325"

	config BR2_PACKAGE_KERNEL_MODULES_ARMV7
	bool "armv7: DNS-327L"

endchoice

endif
```

## package/kexec/Config.in
```kconfig
config BR2_PACKAGE_KEXEC
	bool "kexec"
	help
	  Kexec is a user space utiltity for loading another kernel
	  and asking the currently running kernel to do something with it.

	  http://kernel.org/pub/linux/utils/kernel/kexec

config BR2_PACKAGE_KEXEC_ZLIB
	bool "Kexec with zlib support"
	depends on BR2_PACKAGE_KEXEC
	select BR2_PACKAGE_ZLIB
	help
	  Support for zlib compressed kernel images

config BR2_PACKAGE_KEXEC_LZMA
	bool "Kexec with lzma support"
	depends on BR2_PACKAGE_KEXEC
	select BR2_PACKAGE_XZ
	select BR2_PACKAGE_XZ_LIBS
	help
	  Support for lzma/xz compressed kernel images
```

## package/ksmbd-tools/Config.in
```kconfig
config BR2_PACKAGE_KSMBD_TOOLS
	bool "ksmbd-tools"
	select BR2_PACKAGE_LIBGLIB2
	select BR2_PACKAGE_LIBNL
	help
	  Set of utilities for creating and managing SMB3 shares for the ksmbd kernel
	  module.

	  https://github.com/cifsd-team/ksmbd-tools
```

## package/lftp/Config.in
```kconfig
config BR2_PACKAGE_LFTP
	bool "lftp"
	select BR2_PACKAGE_READLINE
	select BR2_PACKAGE_EXPAT
	select BR2_PACKAGE_LIBICONV
	select BR2_PACKAGE_GETTEXT
	select BR2_PACKAGE_OPENSSL
	help
	  lftp is sophisticated file transfer program with command line interface. It
	  supports FTP/FTPS/SFTP/HFTP, HTTP/HTTPS, FISH, FILE and BitTorrent protocols.

	  http://lftp.yar.ru
```

## package/libantlr/Config.in
```kconfig
config BR2_PACKAGE_LIBANTLR
	bool "libantlr"
	help
	 A language tool that provides a framework for constructing recognizers,
	 interpreters, compilers, and translators from grammatical descriptions  

	  http://www.antlr.org
```

## package/libantlr3/Config.in
```kconfig
config BR2_PACKAGE_LIBANTLR3
	bool "libantlr"
	help
	  ANTLR 3 Runtime

	  http://www.antlr3.org/
```

## package/libavl/Config.in
```kconfig
config BR2_PACKAGE_LIBAVL
	bool "libavl"
	help
	  AVLTree is a small implementation of AVL trees for the C programming language.
	  libavl is not the GNU libavl

	  http://alioth.debian.org/~jblache/forked-daapd/
```

## package/libbsd/Config.in
```kconfig
 config BR2_PACKAGE_LIBBSD
	bool "libbsd"
	help
	  libbsd - Utility functions from BSD systems

	  This library provides useful functions commonly found on BSD systems,
	  and lacking on others like GNU systems, thus making it easier to port
	  projects with strong BSD origins, without needing to embed the same
	  code over and over again on each project.

	  http://http.debian.net/debian/pool/main/libb/libbsd/libbsd_0.7.0.orig.tar.xz
```

## package/libdaemon/Config.in
```kconfig
config BR2_PACKAGE_LIBDAEMON
	bool "libdaemon"
	select BR2_PACKAGE_PKG_CONFIG
	help
	  libdaemon is a lightweight C library that eases the
	  writing of UNIX daemons.

	  http://0pointer.de/lennart/projects/libdaemon/
```

## package/libesmtp/Config.in
```kconfig
config BR2_PACKAGE_LIBESMTP
	bool "libesmtp"
	select BR2_PACKAGE_OPENSSL
	help
		SMTP client which manages posting (or submission of) electronic mail
		via a preconfigured Mail Transport Agent (MTA). It may be used as part of
		a Mail User Agent (MUA) or other program that must be able to post
		electronic mail but where mail functionality is not that program's
		primary purpose.

		http://www.stafford.uklinux.net/libesmtp/index.html
```

## package/libevent2/Config.in
```kconfig
config BR2_PACKAGE_LIBEVENT2
	bool "libevent2"
	help
	  Userspace library for handling asynchronous notifications

	  http://monkey.org/~provos/
```

## package/libexif/Config.in
```kconfig
config BR2_PACKAGE_LIBEXIF
	bool "libexif"
	help
	 libexif is a library for parsing, editing, and saving EXIF data.
	 
	 http://libexif.sourceforge.net/
```

## package/libffi/Config.in
```kconfig
config BR2_PACKAGE_LIBFFI
	bool "libffi"
	help
	  A Portable Foreign Function Interface Library

	  https://sourceware.org/libffi
```

## package/libfuse/Config.in
```kconfig
config BR2_PACKAGE_LIBFUSE
	bool "libfuse"
	depends on BR2_LARGEFILE
	help
	  FUSE (Filesystem in UserSpacE)

	  https://github.com/libfuse/libfuse

comment "libfuse requires a toolchain with LARGEFILE support"
        depends on !BR2_LARGEFILE
```
