## package/nuts/Config.in
```kconfig
config BR2_PACKAGE_NUTS
	bool "nuts"
	select BR2_PACKAGE_NETSNMP
	select BR2_PACKAGE_LIBUSB
	select BR2_PACKAGE_OPENSSL
	select BR2_PACKAGE_LIBGD
	select BR2_PACKAGE_NEON

	help
	  Network UPS Tools is a collection of programs for monitoring and
	  administering UPS, PDU and SCD hardware.

	  http://www.networkupstools.org
```

## package/nzbget/Config.in
```kconfig
config BR2_PACKAGE_NZBGET
	bool "nzbget"
	select BR2_PACKAGE_LIBPAR2
	select BR2_PACKAGE_LIBSIGCPP
	select BR2_PACKAGE_LIBXML2
	select BR2_PACKAGE_NCURSES
	select BR2_PACKAGE_P7ZIP
	select BR2_PACKAGE_UNRAR
	help
	  NZBGet is a command-line based binary newsgrabber for nzb files

	  http://nzbget.sourceforge.net
```

## package/nzbgetweb/Config.in
```kconfig
config BR2_PACKAGE_NZBGETWEB
	bool "nzbgetweb"
	select BR2_PACKAGE_NZBGET
	select BR2_PACKAGE_PHP
	select BR2_PACKAGE_LIGHTTPD
	help
	  NZBGetweb is a web interface to NZBget

	  http://nzbget.sourceforge.net
```

## package/ocaml/Config.in
```kconfig
config BR2_PACKAGE_OCAML
	bool "ocaml"
	help
	  Caml is a general-purpose programming language,
	  designed with program safety and reliability in mind.

	  http://caml.inria.fr/
```

## package/owncloud/Config.in
```kconfig
config BR2_PACKAGE_OWNCLOUD
	bool "owncloud"
	select BR2_PACKAGE_PHP
	select BR2_PACKAGE_LIGHTTPD
	help
	  ownCloud enables universal access to files through the WebDAV standard

	  http://www.owncloud.org
```

## package/p7zip/Config.in
```kconfig
config BR2_PACKAGE_P7ZIP
	bool "p7zip"
	help
	  a quick port of 7-zip for Unix.

	  http://sourceforge.net/projects/p7zip
```

## package/par2cmdline/Config.in
```kconfig
config BR2_PACKAGE_PAR2CMDLINE
	bool "par2cmdline"
	help
	  par2cmdline is a PAR 2.0 compatible file verification and repair tool.

	  http://parchive.sourceforge.net
```

## package/parted/Config.in
```kconfig
config BR2_PACKAGE_PARTED
	bool "parted"
	select BR2_PACKAGE_LIBUUID
	help
	  GNU Parted is a program for manipulating partition tables.
	  http://www.gnu.org/software/parted
```

## package/perl/Config.in
```kconfig
config BR2_PACKAGE_PERL
	bool "perl"
	select BR2_PACKAGE_GROFF
	help
	   perl - Practical Extraction and Report Language

	   http://perl.org/
```

## package/pkg-config/Config.in
```kconfig
config BR2_PACKAGE_HOST_PKGCONFIG
	bool "host-pkgconfig"
	help
	  pkg-config is a system for managing library compile/link
	  flags that works with automake and autoconf. It replaces
	  the ubiquitous *-config scripts you may have seen with a
	  single tool.

	  http://www.freedesktop.org/software/pkgconfig/
```

## package/polipo/Config.in
```kconfig
config BR2_PACKAGE_POLIPO
	bool "polipo"
	help
	  Polipo is a small and fast caching web proxy 

	  http://www.pps.univ-paris-diderot.fr/~jch/software/polipo/
```

## package/popt/Config.in
```kconfig
config BR2_PACKAGE_POPT
	bool "popt"
	help
	  Popt is a C library for parsing command line parameters.

	  https://ftp.openbsd.org/pub/OpenBSD/distfiles

config BR2_PACKAGE_POPT_OPTIM
	string "popt optim"
	depends on BR2_PACKAGE_POPT
	help
	  Compile optimization options (-Os, -O2)
```

## package/pptp/Config.in
```kconfig
config BR2_PACKAGE_PPTP
	bool "pptp"
	select BR2_PACKAGE_PPPD
	help
	  An implementation of the Point-to-point protocol client.

	  http://pptpclient.sourceforge.net/
```

## package/pptpd/Config.in
```kconfig
config BR2_PACKAGE_PPTPD
	bool "pptpd"
	select BR2_PACKAGE_PPPD
	help
	  pptpd is an open source implementation of a PPTP server providing full interoperability with the Microsoft PPTP VPN client.

	  https://sourceforge.net/projects/poptop
```

## package/procps-ng/Config.in
```kconfig
config BR2_PACKAGE_PROCPS_NG
	bool "procps-ng"
	select BR2_PACKAGE_NCURSES
	help
	  A fork of procps: contains free, kill, pkill, pgrep, pmap, ps, pwdx, skill, slabtop, snice, sysctl, tload, top, uptime, vmstat, w, and watch

	  https://sourceforge.net/projects/procps-ng
```

## package/pycrypto/Config.in
```kconfig
config BR2_PACKAGE_PYCRYPTO
	bool "pycrypto"
	select BR2_PACKAGE_PYTHON
	help
	  The Python Cryptography Toolkit

	  https://www.dlitz.net/software/pycrypto
```

## package/pycurl/Config.in
```kconfig
config BR2_PACKAGE_PYCURL
	bool "pycurl"
	select BR2_PACKAGE_PYTHON
	select BR2_PACKAGE_LIBCURL
	help
	  Python interface to libcurl

	  http://pycurl.sourceforge.net/
```

## package/pyload/Config.in
```kconfig
config BR2_PACKAGE_PYLOAD
	bool "pyload"
	select BR2_PACKAGE_PYTHON
	select BR2_PACKAGE_PYOPENSSL
	select BR2_PACKAGE_PYCURL
	select BR2_PACKAGE_PYCRYPTO
	help
	  fast, lightweight and full featured Pyhton-based download manager

	  http://pyload.org/
```

## package/pynacl/Config.in
```kconfig
config BR2_PACKAGE_PYNACL
	bool "pynacl"
	select BR2_PACKAGE_PYTHON
	select BR2_PACKAGE_LIBSODIUM
	help
	  Python binding to the libsodium library

	  https://github.com/pyca/pynacl
```

## package/pyopenssl/Config.in
```kconfig
config BR2_PACKAGE_PYOPENSSL
	bool "pyopenssl"
	select BR2_PACKAGE_PYTHON
	help
	  Python interface to the OpenSSL library

	  https://launchpad.net/pyopenssl
```

## package/python/Config.in
```kconfig
config BR2_PACKAGE_PYTHON
	bool "python"
	help
	  The python language interpreter.

	  http://www.python.org/

config BR2_PACKAGE_PYTHON_DEV
	depends on BR2_PACKAGE_PYTHON
	bool "development files on target"
	help
	  If enabled, development files (headers and static libpython) will be
	  installed on the target.

choice
	prompt "Module format to install"
	depends on BR2_PACKAGE_PYTHON
	default BR2_PACKAGE_PYTHON_PY_ONLY
	help
	  Select Python module format to install on target (py, pyc or both)

config BR2_PACKAGE_PYTHON_PY_ONLY
	bool ".py sources only"

config BR2_PACKAGE_PYTHON_PYC_ONLY
	bool ".pyc compiled sources only"

config BR2_PACKAGE_PYTHON_PY_PYC
	bool ".py sources and .pyc compiled"

endchoice

comment "The following modules are unusual or require extra libraries"
	depends on BR2_PACKAGE_PYTHON

config BR2_PACKAGE_PYTHON_BSDDB
	depends on BR2_PACKAGE_PYTHON
	select BR2_PACKAGE_DB
	bool "bsddb module"
	help
	  bsddb module for Python. Deprecated since 2.6

config BR2_PACKAGE_PYTHON_GDBM
	depends on BR2_PACKAGE_PYTHON
	select BR2_PACKAGE_GDBM
	bool "gdbm module"
	help
	  gdbm module for Python.

config BR2_PACKAGE_PYTHON_SQLITE3
	depends on BR2_PACKAGE_PYTHON
	select BR2_PACKAGE_SQLITE
	bool "sqlite3 module"
	help
	  sqlite3 module for Python.

config BR2_PACKAGE_PYTHON_UNICODEDATA
	depends on BR2_PACKAGE_PYTHON
	bool "unicodedata module"
	help
	  Unicode character database (used by stringprep module) (large).

config BR2_PACKAGE_PYTHON_LOCALE
	depends on BR2_PACKAGE_PYTHON
	select BR2_PACKAGE_GETTEXT
	bool "locale module"
	help
	  Support for POSIX locales

config BR2_PACKAGE_PYTHON_CODECSCJK
	depends on BR2_PACKAGE_PYTHON
	bool "codecscjk module"
	help
	  Chinese/Japanese/Korean codecs module for Python (large).

config BR2_PACKAGE_PYTHON_CURSES
	depends on BR2_PACKAGE_PYTHON
	select BR2_PACKAGE_NCURSES
	bool "curses module"
	help
	  curses module for Python.

config BR2_PACKAGE_PYTHON_READLINE
	depends on BR2_PACKAGE_PYTHON
	select BR2_PACKAGE_READLINE
	bool "readline"
	help
	  readline module for Python (required for command-line
	  editing in the Python shell).

config BR2_PACKAGE_PYTHON_NIS
	depends on BR2_PACKAGE_PYTHON
	bool "nis module"
	help
	  nis module for Python.

config BR2_PACKAGE_PYTHON_LIBFFI
	depends on BR2_PACKAGE_PYTHON
	select BR2_PACKAGE_LIBFFI
    default y
	bool "libffi"
	help
	  use system libffi

config BR2_PACKAGE_PYTHON_PYEXPAT
	depends on BR2_PACKAGE_PYTHON
	select BR2_PACKAGE_EXPAT
	bool "pyexpat"
	help
	  pyexpat module for Python.

config BR2_PACKAGE_PYTHON_SSL
	depends on BR2_PACKAGE_PYTHON
	select BR2_PACKAGE_OPENSSL
	bool "ssl"
	help
	  _ssl module for Python (required for https in urllib etc).

config BR2_PACKAGE_PYTHON_BZIP2
	depends on BR2_PACKAGE_PYTHON
	select BR2_PACKAGE_BZIP2
	bool "bzip2"
	help
	  bzip2 module for Python

config BR2_PACKAGE_PYTHON_ZLIB
	depends on BR2_PACKAGE_PYTHON
	select BR2_PACKAGE_ZLIB
	bool "zlib"
	help
	  zlib module for Python

config BR2_PACKAGE_PYTHON_TKINTER
	depends on BR2_PACKAGE_PYTHON
	select BR2_PACKAGE_TCL
	bool "tkinter module"
	help
	  tkinter module for Python.
```

## package/quota-tools/Config.in
```kconfig
config BR2_PACKAGE_QUOTA_TOOLS
	bool "quota-tools"
	help
	  Tools and patches for the Linux Diskquota system

	  https://sourceforge.net/projects/linuxquota
```

## package/readline/Config.in
```kconfig
config BR2_PACKAGE_READLINE
	bool "readline"
	select BR2_PACKAGE_NCURSES
	select BR2_PACKAGE_NCURSES_TARGET_PANEL
	select BR2_PACKAGE_NCURSES_TARGET_FORM
	select BR2_PACKAGE_NCURSES_TARGET_MENU
	help
	    Enable GNU readline support?
```

## package/rpcbind/Config.in
```kconfig
config BR2_PACKAGE_RPCBIND
	bool "rpcbind"
	select BR2_PACKAGE_LIBTIRPC
	help
	  A server that converts RPC program numbers into universal addresses.

	  http://sourceforge.net/projects/rpcbind
```

## package/rsnapshot/Config.in
```kconfig
config BR2_PACKAGE_RSNAPSHOT
	bool "rsnapshot"
	select BR2_PACKAGE_PERL
	select BR2_PACKAGE_RSYNC
	help
	 rsnapshot is a filesystem snapshot utility for making backups of local and remote systems. 
	 Using rsync and hard links, it is possible to keep multiple, full backups instantly available.
	 The disk space required is just a little more than the space of one full backup, plus incrementals.

	 http://www.rsnapshot.org/
```
