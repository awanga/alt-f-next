## package/cryptlib/Config.in
```kconfig
config BR2_PACKAGE_CRYPTLIB
	bool "cryptlib"
	help
	  a set of layered security services and associated programming interface

	  https://www.cs.auckland.ac.nz/~pgut001/cryptlib
```

## package/cryptodev/Config.in
```kconfig
config BR2_PACKAGE_CRYPTODEV
	bool "cryptodev"
	help
	  Cryptodev-linux is a device that allows access to Linux kernel cryptographic drivers; thus allowing of userspace applications to take advantage of hardware accelerators

	  http://cryptodev-linux.org

config BR2_PACKAGE_CRYPTODEV_HEADER_ONLY
	bool "criptodev-header"
	depends on BR2_PACKAGE_CRYPTODEV
	help
	  Only install cryptodev.h on staging dir for openssl usage
```

## package/cryptography/Config.in
```kconfig
config BR2_PACKAGE_CRYPTOGRAPHY
	bool "cryptography"
	select BR2_PACKAGE_PYTHON
	select BR2_PACKAGE_CFFI
	help
	  Provides cryptographic recipes and primitives to Python developers

	  https://pypi.python.org/pypi/cryptography
```

## package/cryptopp/Config.in
```kconfig
config BR2_PACKAGE_CRYPTOPP
	bool "cryptopp"
	help
	  a free C++ class library of cryptographic schemes

	  http://www.cryptopp.com
```

## package/cryptsetup/Config.in
```kconfig
config BR2_PACKAGE_CRYPTSETUP
	bool "cryptsetup"
	select BR2_PACKAGE_LVM2
	select BR2_PACKAGE_LIBUUID
	select BR2_PACKAGE_LIBGCRYPT
	select BR2_PACKAGE_POPT
	select BR2_PACKAGE_LIBICONV
	help
	 Setup cryptographic volumes for dm-crypt (including LUKS extension)
	 
	 https://gitlab.com/cryptsetup/cryptsetup
```

## package/database/Config.in
```kconfig
menu "Database"
source "package/database/db/Config.in"
source "package/database/gdbm/Config.in"
source "package/database/mysql/Config.in"
source "package/database/sqlite/Config.in"
endmenu
```

## package/database/db/Config.in
```kconfig
config BR2_PACKAGE_DB
	bool "db"
	help
	  Berkeley DB

	  http://www.oracle.com/us/products/database/berkeley-db
```

## package/database/gdbm/Config.in
```kconfig
config BR2_PACKAGE_GDBM
	bool "gdbm"
	help
	 GNU dbm is a set of database routines that use extensible hashing.
	 
	 http://www.gnu.org/software/gdbm/
```

## package/database/mysql/Config.in
```kconfig
config BR2_PACKAGE_MYSQL
	bool "MySQL client"
	depends on BR2_INSTALL_LIBSTDCPP
	depends on !BR2_avr32
	select BR2_PACKAGE_READLINE
	select BR2_PACKAGE_OPENSSL
	help
	  Install the MySQL client on the target

	  http://www.mysql.com/

config BR2_PACKAGE_MYSQL_SERVER
	bool "MySQL server"
	depends on BR2_PACKAGE_MYSQL
	help
	  Install the MySQL server on the target.

config BR2_PACKAGE_MYSQL_LIBS
	bool "MySQL libraries"
	depends on BR2_PACKAGE_MYSQL
	help
	  Install the MySQL libraries on the target.
```

## package/database/sqlite/Config.in
```kconfig
config BR2_PACKAGE_SQLITE
	bool "sqlite"
	help
	  SQLite is a small C library that implements a self-contained,
	  embeddable, zero-configuration SQL database engine.

	  http://www.sqlite.org/

config BR2_PACKAGE_SQLITE_READLINE
	bool "Command-line editing"
	depends on BR2_PACKAGE_SQLITE
	select BR2_PACKAGE_READLINE
	help
	  Enable command-line editing. This requires ncurses and readline.


config BR2_PACKAGE_SQLITE_LIBS
	bool "sqlite libs"
	default y
	depends on BR2_PACKAGE_SQLITE
	help
	  install sqlite libraries

config BR2_PACKAGE_SQLITE_PROGS
	bool "sqlite progs"
	depends on BR2_PACKAGE_SQLITE
	help
	  install sqlite binaries
```

## package/davfs2/Config.in
```kconfig
config BR2_PACKAGE_DAVFS2
	bool "davfs2"
	select BR2_PACKAGE_NEON
	help
	  davfs2 will work with most WebDAV servers needing little or no configuration

	  http://savannah.nongnu.org/projects/davfs2
```

## package/devio/Config.in
```kconfig
config BR2_PACKAGE_DEVIO_HOST
	bool "devio"
	help
	  devio (for the host) is a command line program intended to read and write from block devices.

	  http://sourceforge.net/projects/devio
```

## package/dosfstools/Config.in
```kconfig
config BR2_PACKAGE_DOSFSTOOLS
	bool "dosfstools"
	help
	  Tools for creating and checking DOS FAT filesystems.

	  http://sources.buildroot.net
```

## package/dropbear/Config.in
```kconfig
config BR2_PACKAGE_DROPBEAR
	bool "dropbear"
	select BR2_PACKAGE_ZLIB
	help
	  A small SSH 2 server designed for small memory environments.

	  http://matt.ucc.asn.au/dropbear/dropbear.html

config BR2_PACKAGE_DROPBEAR_OPTIM
	string "busybox optim"
	depends on BR2_PACKAGE_DROPBEAR
	help
	  Compile optimization options (-Os, -O2)
```

## package/duplicity/Config.in
```kconfig
config BR2_PACKAGE_DUPLICITY
	bool "duplicity"
	select BR2_PACKAGE_PYCRYPTO
	select BR2_PACKAGE_LIBRSYNC
	select BR2_PACKAGE_GNUPG
	help
	  Duplicity backs directories by producing encrypted tar-format volumes
	  and uploading them to a remote or local file server.
	  Because duplicity uses librsync, the incremental archives are space efficient
	  and only record the parts of files that have changed since the last backup.

	  http://duplicity.nongnu.org
```

## package/esmtp/Config.in
```kconfig
config BR2_PACKAGE_ESMTP
	bool "esmtp"
	select BR2_PACKAGE_LIBESMTP
	help
		esmtp is a user configurable relay-only Mail Transfer Agent (MTA)
		with a sendmail compatible syntax. It's based on libESMTP supporting
		the AUTH (including the CRAM-MD5 and NTLM SASL mechanisms) and the
		StartTLS SMTP extensions. 

		http://esmtp.sourceforge.net/index.html
```

## package/fdupes/Config.in
```kconfig
config BR2_PACKAGE_FDUPES
	bool "fdupes"
	help
	  a program for identifying or deleting duplicate files residing within specified directories

	  https://github.com/adrianlopezroche/fdupes
```

## package/foomatic-db/Config.in
```kconfig
config BR2_PACKAGE_FOOMATIC_DB
	bool "foomatic-db"
	help
	 The collected knowledge about printers, drivers, and driver options in XML files,
	 used by foomatic-db-engine to generate PPD files. It also contains manufacturer-
	 supplied PPD files which got released under free software licenses.
	 Packaged together with foomatic-db-engine, and distribute only the PPD
	
	 http://www.openprinting.org/
```

## package/foomatic-filters/Config.in
```kconfig
config BR2_PACKAGE_FOOMATIC_FILTERS
	bool "foomatic-filters"
	select BR2_PACKAGE_A2PS
	select BR2_PACKAGE_GS
	select BR2_PACKAGE_CUPS
	select BR2_PACKAGE_FOOMATIC_DB
	help
	Filter scripts used by the printer spoolers to convert the incoming
	PostScript data into the printer's native format using a
	printer/driver specific, but spooler-independent PPD file.
	
	  http://www.openprinting.org/
```

## package/forked-daapd/Config.in
```kconfig
config BR2_PACKAGE_FORKED_DAAPD
	bool "forked-daapd"
	help
	  forked-daapd is a Linux/FreeBSD media server

	  https://github.com/ejurgensen/forked-daapd
```

## package/gawk/Config.in
```kconfig
config BR2_PACKAGE_GAWK
	bool "gawk"
	depends on BR2_USE_WCHAR
	select BR2_PACKAGE_LIBINTL
	select BR2_PACKAGE_GETTEXT
	help
	  A special-purpose programming language which is data driven
	  rather than procedural.  Allows for simple data-reformatting jobs
	  with just a few lines of code.

	  http://www.gnu.org/software/gawk/
```

## package/git/Config.in
```kconfig
config BR2_PACKAGE_GIT
	bool "git"
	select BR2_PACKAGE_EXPAT
	select BR2_PACKAGE_LIBCURL
	select BR2_PACKAGE_PCRE
	select BR2_PACKAGE_PERL
	help
	  Git is a free & open source, distributed version control system designed to handle
	  everything from small to very large projects with speed and efficiency.
	
	  http://git-scm.com/
```

## package/gnupg/Config.in
```kconfig
config BR2_PACKAGE_GNUPG
	bool "gnupg"
	select BR2_PACKAGE_READLINE
	select BR2_PACKAGE_LIBICONV
	select BR2_PACKAGE_LIBUSB
	help
	  GnuPG allows to encrypt and sign your data and communication

	  http://www.gnupg.org
```

## package/gptfdisk/Config.in
```kconfig
config BR2_PACKAGE_GPTFDISK
	bool "gptfdisk"
	select BR2_PACKAGE_POPT
	select BR2_PACKAGE_LIBUUID
	help
	  The gdisk and sgdisk programs work on Globally Unique Identifier (GUID) Partition Table (GPT) disks
	  http://www.rodsbooks.com/gdisk/

config BR2_PACKAGE_GPTFDISK_SGDISK
	bool "sgdisk"
	default y
	depends on BR2_PACKAGE_GPTFDISK

config BR2_PACKAGE_GPTFDISK_GDISK
	bool "gdisk"
	depends on BR2_PACKAGE_GPTFDISK

config BR2_PACKAGE_GPTFDISK_CGDISK
	bool "cgdisk"
	depends on BR2_PACKAGE_GPTFDISK
	select BR2_PACKAGE_NCURSES

config BR2_PACKAGE_GPTFDISK_FIXPARTS
	bool "fixparts"
	depends on BR2_PACKAGE_GPTFDISK
```

## package/groff/Config.in
```kconfig
config BR2_PACKAGE_GROFF
	bool "groff"
	help
	  The groff package provides compatible versions of troff, nroff, eqn,
	  tbl, and other Unix text formatting utilities.

	  http://www.gnu.org/software/groff/
```
