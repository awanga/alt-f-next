## configs/alt-f_base_defconfig
```kconfig
BR2_arm=y
BR2_ARM_INSTRUCTIONS_THUMB=y
BR2_PROJECT="base"
BR2_WGET="wget --passive-ftp -nd"
BR2_GIT="git clone"
BR2_DL_DIR="$(BASE_DIR)/dl"
BR2_KERNEL_MIRROR="http://www.kernel.org/pub/"
BR2_PIC_PIE=y
BR2_RELRO_PARTIAL=y
BR2_PACKAGE_HOST_LINUX_HEADERS_CUSTOM_4_19=y
BR2_UCLIBC_CONFIG="./board/dns32x/pkgs/uclibc.config"
BR2_TOOLCHAIN_BUILDROOT_WCHAR=y
BR2_PTHREAD_DEBUG=y
BR2_BINUTILS_EXTRA_CONFIG_OPTIONS="--enable-gold --enable-interwork"
BR2_EXTRA_GCC_CONFIG_OPTIONS="--enable-interwork"
BR2_TOOLCHAIN_BUILDROOT_CXX=y
BR2_GCC_ENABLE_LTO=y
BR2_GCC_ENABLE_GRAPHITE=y
BR2_TARGET_OPTIMIZATION="-pipe -fomit-frame-pointer -mabi=aapcs-linux"
BR2_ROOTFS_SKELETON_CUSTOM=y
BR2_ROOTFS_SKELETON_CUSTOM_PATH="./board/dns32x/customroot"
# BR2_ENABLE_LOCALE_PURGE is not set
BR2_ROOTFS_POST_BUILD_SCRIPT="./board/dns32x/configfs"
BR2_LINUX_KERNEL=y
BR2_LINUX_KERNEL_CUSTOM_VERSION=y
BR2_LINUX_KERNEL_CUSTOM_VERSION_VALUE="4.19.140"
BR2_LINUX_KERNEL_USE_CUSTOM_CONFIG=y
BR2_LINUX_KERNEL_CUSTOM_CONFIG_FILE="./board/dns32x/pkgs/linux.config"
BR2_LINUX_KERNEL_XZ=y
BR2_LINUX_KERNEL_EXT_AUFS=y
BR2_LINUX_KERNEL_EXT_AUFS_SERIES_4=y
BR2_LINUX_KERNEL_EXT_AUFS_VERSION="aufs4.19.63+"
BR2_PACKAGE_BUSYBOX_CONFIG="./board/dns32x/pkgs/busybox.config"
# BR2_TARGET_ROOTFS_TAR is not set
```

## configs/alt-f_dns323_defconfig
```kconfig
BR2_arm=y
BR2_ARM_INSTRUCTIONS_THUMB=y
BR2_PROJECT="dns323"
BR2_WGET="wget --passive-ftp -nd"
BR2_GIT="git clone"
BR2_DL_DIR="$(BASE_DIR)/dl"
BR2_KERNEL_MIRROR="http://www.kernel.org/pub/"
BR2_PIC_PIE=y
BR2_RELRO_PARTIAL=y
BR2_PACKAGE_HOST_LINUX_HEADERS_CUSTOM_5_4=y
BR2_UCLIBC_CONFIG="./board/dns32x/pkgs/uclibc.config"
BR2_TOOLCHAIN_BUILDROOT_WCHAR=y
BR2_PTHREAD_DEBUG=y
BR2_BINUTILS_EXTRA_CONFIG_OPTIONS="--enable-gold --enable-interwork"
BR2_EXTRA_GCC_CONFIG_OPTIONS="--enable-interwork"
BR2_TOOLCHAIN_BUILDROOT_CXX=y
BR2_GCC_ENABLE_LTO=y
BR2_GCC_ENABLE_GRAPHITE=y
BR2_TARGET_OPTIMIZATION="-pipe -fomit-frame-pointer -mabi=aapcs-linux"
BR2_ROOTFS_SKELETON_CUSTOM=y
BR2_ROOTFS_SKELETON_CUSTOM_PATH="./board/dns32x/customroot"
BR2_ROOTFS_DEVICE_CREATION_DYNAMIC_MDEV=y
# BR2_ENABLE_LOCALE_PURGE is not set
BR2_ROOTFS_POST_BUILD_SCRIPT="./board/dns32x/configfs"
BR2_ROOTFS_POST_IMAGE_SCRIPT="./board/dns32x/post_script.sh"
BR2_LINUX_KERNEL=y
BR2_LINUX_KERNEL_CUSTOM_VERSION=y
BR2_LINUX_KERNEL_CUSTOM_VERSION_VALUE="5.4.116"
BR2_LINUX_KERNEL_USE_CUSTOM_CONFIG=y
BR2_LINUX_KERNEL_CUSTOM_CONFIG_FILE="./board/dns32x/dns323/linux.config"
BR2_LINUX_KERNEL_XZ=y
BR2_LINUX_KERNEL_EXT_AUFS=y
BR2_LINUX_KERNEL_EXT_AUFS_SERIES_5=y
BR2_LINUX_KERNEL_EXT_AUFS_VERSION="aufs5.4.3"
BR2_PACKAGE_BUSYBOX_CONFIG="./board/dns32x/pkgs/busybox.config"
BR2_PACKAGE_BUSYBOX_SHOW_OTHERS=y
BR2_PACKAGE_KEXEC=y
BR2_PACKAGE_KEXEC_ZLIB=y
BR2_PACKAGE_CIFS_UTILS=y
BR2_PACKAGE_DOSFSTOOLS=y
BR2_PACKAGE_DOSFSTOOLS_FSCK_FAT=y
BR2_PACKAGE_E2FSPROGS=y
BR2_PACKAGE_E2FSPROGS_RESIZE2FS=y
BR2_PACKAGE_MTD=y
# BR2_PACKAGE_MTD_UBIATTACH is not set
# BR2_PACKAGE_MTD_UBICRC32 is not set
# BR2_PACKAGE_MTD_UBIDETACH is not set
# BR2_PACKAGE_MTD_UBIFORMAT is not set
# BR2_PACKAGE_MTD_UBIMKVOL is not set
# BR2_PACKAGE_MTD_UBINFO is not set
# BR2_PACKAGE_MTD_UBINIZE is not set
# BR2_PACKAGE_MTD_UBIRENAME is not set
# BR2_PACKAGE_MTD_UBIRMVOL is not set
# BR2_PACKAGE_MTD_UBIRSVOL is not set
# BR2_PACKAGE_MTD_UBIUPDATEVOL is not set
# BR2_PACKAGE_MTD_UBIBLOCK is not set
BR2_PACKAGE_NFS_UTILS=y
BR2_PACKAGE_NTFS_3G=y
BR2_PACKAGE_GPTFDISK=y
BR2_PACKAGE_GPTFDISK_SGDISK=y
BR2_PACKAGE_MDADM=y
BR2_PACKAGE_SMARTMONTOOLS=y
BR2_PACKAGE_LIBOPENSSL_BIN=y
BR2_PACKAGE_LIBGPIOD=y
BR2_PACKAGE_LIBGPIOD_TOOLS=y
BR2_PACKAGE_MSMTP=y
BR2_PACKAGE_DROPBEAR=y
BR2_PACKAGE_INADYN_MT=y
BR2_PACKAGE_RSYNC=y
BR2_PACKAGE_STUNNEL=y
BR2_PACKAGE_VSFTPD=y
BR2_PACKAGE_WGET=y
BR2_PACKAGE_ALT_F_UTILS=y
BR2_PACKAGE_ALT_F_UTILS_TARGET=y
BR2_PACKAGE_AT=y
BR2_PACKAGE_ACL=y
BR2_PACKAGE_UTIL_LINUX_FDISKS=y
BR2_PACKAGE_UTIL_LINUX_BLKID=y
BR2_PACKAGE_UTIL_LINUX_FSCK=y
BR2_PACKAGE_UTIL_LINUX_UUIDGEN=y
# BR2_TARGET_ROOTFS_TAR is not set
BR2_PACKAGE_HOST_ALT_F_UTILS=y
BR2_PACKAGE_HOST_SQUASHFS=y
BR2_PACKAGE_HOST_UBOOT_TOOLS=y
```

## configs/alt-f_dns325_defconfig
```kconfig
BR2_arm=y
BR2_ARM_INSTRUCTIONS_THUMB=y
BR2_PROJECT="dns325"
BR2_WGET="wget --passive-ftp -nd"
BR2_GIT="git clone"
BR2_DL_DIR="$(BASE_DIR)/dl"
BR2_KERNEL_MIRROR="http://www.kernel.org/pub/"
BR2_PACKAGE_HOST_LINUX_HEADERS_CUSTOM_4_9=y
BR2_UCLIBC_CONFIG="./board/dns32x/pkgs/uclibc.config"
BR2_TOOLCHAIN_BUILDROOT_WCHAR=y
BR2_PTHREAD_DEBUG=y
BR2_BINUTILS_VERSION_2_28_X=y
BR2_BINUTILS_EXTRA_CONFIG_OPTIONS="--enable-gold --enable-interwork"
BR2_GCC_VERSION_4_9_X=y
BR2_EXTRA_GCC_CONFIG_OPTIONS="--enable-interwork"
BR2_TOOLCHAIN_BUILDROOT_CXX=y
BR2_GCC_ENABLE_LTO=y
BR2_GCC_ENABLE_GRAPHITE=y
BR2_TARGET_OPTIMIZATION="-pipe -fomit-frame-pointer -mabi=aapcs-linux"
BR2_ROOTFS_SKELETON_CUSTOM=y
BR2_ROOTFS_SKELETON_CUSTOM_PATH="./board/dns32x/customroot"
BR2_TARGET_GENERIC_GETTY_PORT="ttyS0"
BR2_TARGET_GENERIC_GETTY_BAUDRATE_115200=y
# BR2_ENABLE_LOCALE_PURGE is not set
BR2_ROOTFS_POST_BUILD_SCRIPT="./board/dns32x/configfs"
BR2_ROOTFS_POST_IMAGE_SCRIPT="./board/dns32x/post_script.sh"
BR2_LINUX_KERNEL=y
BR2_LINUX_KERNEL_CUSTOM_VERSION=y
BR2_LINUX_KERNEL_CUSTOM_VERSION_VALUE="4.9.227"
BR2_LINUX_KERNEL_USE_CUSTOM_CONFIG=y
BR2_LINUX_KERNEL_CUSTOM_CONFIG_FILE="./board/dns32x/dns325/linux.config"
BR2_LINUX_KERNEL_XZ=y
BR2_LINUX_KERNEL_EXT_AUFS=y
BR2_LINUX_KERNEL_EXT_AUFS_SERIES_4=y
BR2_LINUX_KERNEL_EXT_AUFS_VERSION="aufs4.9.94+"
BR2_PACKAGE_BUSYBOX_CONFIG="./board/dns32x/pkgs/busybox.config"
BR2_PACKAGE_BUSYBOX_SHOW_OTHERS=y
BR2_PACKAGE_KEXEC=y
BR2_PACKAGE_KEXEC_ZLIB=y
# BR2_PACKAGE_CIFS_UTILS is not set
BR2_PACKAGE_DOSFSTOOLS=y
# BR2_PACKAGE_NFS_UTILS is not set
BR2_PACKAGE_NTFS_3G=y
BR2_PACKAGE_GPTFDISK=y
BR2_PACKAGE_GPTFDISK_SGDISK=y
BR2_PACKAGE_MDADM=y
BR2_PACKAGE_SMARTMONTOOLS=y
BR2_PACKAGE_OPENSSL_BIN=y
BR2_PACKAGE_MSMTP=y
BR2_PACKAGE_DROPBEAR=y
BR2_PACKAGE_INADYN_MT=y
# BR2_PACKAGE_RPCBIND is not set
BR2_PACKAGE_RSYNC=y
BR2_PACKAGE_STUNNEL=y
BR2_PACKAGE_VSFTPD=y
BR2_PACKAGE_WGET=y
BR2_PACKAGE_ALT_F_UTILS=y
BR2_PACKAGE_ALT_F_UTILS_TARGET=y
BR2_PACKAGE_AT=y
BR2_PACKAGE_ACL=y
BR2_PACKAGE_UTIL_LINUX_BINARIES=y
# BR2_TARGET_ROOTFS_TAR is not set
BR2_PACKAGE_HOST_ALT_F_UTILS=y
BR2_PACKAGE_HOST_MKE2IMG=y
BR2_PACKAGE_HOST_SQUASHFS=y
BR2_PACKAGE_HOST_UBOOT_TOOLS=y
```

## configs/alt-f_dns327_defconfig
```kconfig
BR2_arm=y
BR2_PROJECT="dns327"
BR2_WGET="wget --passive-ftp -nd"
BR2_GIT="git clone"
BR2_DL_DIR="$(BASE_DIR)/dl"
BR2_KERNEL_MIRROR="http://www.kernel.org/pub/"
BR2_OPTIMIZE_2=y
BR2_UCLIBC_CONFIG="./board/dns32x/pkgs/uclibc.config"
BR2_TOOLCHAIN_BUILDROOT_WCHAR=y
BR2_TOOLCHAIN_BUILDROOT_CXX=y
BR2_PTHREAD_DEBUG=y
BR2_BINUTILS_VERSION_2_28_X=y
BR2_BINUTILS_EXTRA_CONFIG_OPTIONS="--enable-gold --enable-interwork"
BR2_GCC_VERSION_4_9_X=y
BR2_EXTRA_GCC_CONFIG_OPTIONS="--enable-interwork"
BR2_TOOLCHAIN_BUILDROOT_CXX=y
BR2_GCC_ENABLE_LTO=y
BR2_GCC_ENABLE_GRAPHITE=y
BR2_TARGET_OPTIMIZATION="-pipe -fomit-frame-pointer -mabi=aapcs-linux"
BR2_ROOTFS_SKELETON_CUSTOM=y
BR2_ROOTFS_SKELETON_CUSTOM_PATH="./board/dns32x/customroot"
BR2_TARGET_GENERIC_GETTY_PORT="ttyS0"
BR2_TARGET_GENERIC_GETTY_BAUDRATE_115200=y
# BR2_ENABLE_LOCALE_PURGE is not set
BR2_ROOTFS_POST_BUILD_SCRIPT="./board/dns32x/configfs"
BR2_LINUX_KERNEL=y
BR2_LINUX_KERNEL_USE_CUSTOM_CONFIG=y
BR2_LINUX_KERNEL_CUSTOM_CONFIG_FILE="./board/dns32x/pkgs/linux.config"
BR2_LINUX_KERNEL_EXT_AUFS=y
BR2_LINUX_KERNEL_EXT_AUFS_SERIES_4=y
BR2_LINUX_KERNEL_EXT_AUFS_VERSION="aufs4.11.7+"
BR2_PACKAGE_BUSYBOX_CONFIG="./board/dns32x/pkgs/busybox.config"
BR2_PACKAGE_FFMPEG=y
BR2_PACKAGE_LAME=y
BR2_PACKAGE_XZ=y
BR2_PACKAGE_KEXEC=y
BR2_PACKAGE_KEXEC_ZLIB=y
BR2_PACKAGE_BTRFS_PROGS=y
BR2_PACKAGE_CIFS_UTILS=y
BR2_PACKAGE_DOSFSTOOLS=y
BR2_PACKAGE_NFS_UTILS=y
BR2_PACKAGE_NTFS_3G=y
BR2_PACKAGE_SQUASHFS=y
BR2_PACKAGE_GPTFDISK=y
BR2_PACKAGE_GPTFDISK_SGDISK=y
BR2_PACKAGE_DBUS=y
BR2_PACKAGE_MDADM=y
BR2_PACKAGE_SMARTMONTOOLS=y
BR2_PACKAGE_ALSA_LIB=y
BR2_PACKAGE_LIBID3TAG=y
BR2_PACKAGE_LIBVORBIS=y
BR2_PACKAGE_OPENSSL_BIN=y
BR2_PACKAGE_SQLITE=y
BR2_PACKAGE_LIBCONFUSE=y
BR2_PACKAGE_JPEG=y
BR2_PACKAGE_LIBEXIF=y
BR2_PACKAGE_MXML=y
BR2_PACKAGE_CURL=y
BR2_PACKAGE_LIBICONV=y
BR2_PACKAGE_READLINE=y
BR2_PACKAGE_MSMTP=y
BR2_PACKAGE_AVAHI=y
BR2_PACKAGE_AVAHI_DAEMON=y
BR2_PACKAGE_DNSMASQ=y
BR2_PACKAGE_DROPBEAR=y
BR2_PACKAGE_INADYN=y
BR2_PACKAGE_NETATALK=y
BR2_PACKAGE_OPENSSH=y
BR2_PACKAGE_RSYNC=y
BR2_PACKAGE_STUNNEL=y
BR2_PACKAGE_TRANSMISSION=y
BR2_PACKAGE_VSFTPD=y
BR2_PACKAGE_ALT_F_UTILS=y
BR2_PACKAGE_ALT_F_UTILS_TARGET=y
BR2_PACKAGE_ALT_F_UTILS_HOST=y
BR2_PACKAGE_AT=y
BR2_PACKAGE_ACL=y
BR2_PACKAGE_UTIL_LINUX_BINARIES=y
BR2_TARGET_ROOTFS_EXT2=y
BR2_TARGET_ROOTFS_EXT2_BLOCKS=0
# BR2_TARGET_ROOTFS_TAR is not set
```

## package/Alt-F-utils/Config.in
```kconfig
config BR2_PACKAGE_ALT_F_UTILS
	bool "Alt-F-utils"
	help
	  Provides fan control, hdd sleep and buttons press detection
```
