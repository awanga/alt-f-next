## package/a2ps/Config.in
```kconfig
config BR2_PACKAGE_A2PS
	bool "a2ps"
	select BR2_PACKAGE_FILE
	help
	  GNU a2ps is an Any to PostScript filter. Of course it processes plain
	  text files, but also pretty prints quite a few popular languages.
	
	  http://www-inf.enst.fr/~demaille/a2ps
```

## package/acl/Config.in
```kconfig
config BR2_PACKAGE_ACL
	bool "acl"
	select BR2_PACKAGE_ATTR
	select BR2_PACKAGE_LIBINTL
	help
	  The acl package contains utilities to administer Access Control Lists, which are used to define more fine-grained discretionary access rights for files and directories.

	  http://download.savannah.gnu.org/releases/acl
```

## package/alt-f-utils/Config.in
```kconfig
config BR2_PACKAGE_ALT_F_UTILS
	bool "Alt-F-utils"
	help
	  Provides fan control, hdd sleep and buttons press detection for the DNS-323/321

config BR2_PACKAGE_ALT_F_UTILS_TARGET
	bool "Alt-F-utils-target"
	depends on BR2_PACKAGE_ALT_F_UTILS
	help
	  tools for the target

config BR2_PACKAGE_ALT_F_UTILS_HOST
	bool "Alt-F-utils-host"
	depends on BR2_PACKAGE_ALT_F_UTILS
	help
	  firmware builder for the host
```

## package/alt-f-utils/Config.in.host
```kconfig
config BR2_PACKAGE_HOST_ALT_F_UTILS
	bool "Alt-F-utils-host"
	depends on BR2_PACKAGE_ALT_F_UTILS
	help
	  firmware builder for the host
```

## package/amule/Config.in
```kconfig
config BR2_PACKAGE_AMULE
	bool "amule"
	select BR2_PACKAGE_WXWIDGETS
	select BR2_PACKAGE_CRYPTOPP
	select BR2_PACKAGE_PERL
	select BR2_PACKAGE_LIBUPNP
	select BR2_PACKAGE_LIBPNG
	select BR2_PACKAGE_READLINE
	help
	  an eMule-like client for the eD2k and Kademlia networks, supporting multiple platforms

	  http://www.amule.org
```

## package/aria2/Config.in
```kconfig
config BR2_PACKAGE_ARIA2
	bool "aria2"
	help
	  a lightweight multi-protocol download command-line utility supporting HTTP/HTTPS, FTP, BitTorrent and Metalink.

	  https://github.com/tatsuhiro-t/aria2
```

## package/aria2web/Config.in
```kconfig
config BR2_PACKAGE_ARIA2WEB
	bool "aria2web"
	select BR2_PACKAGE_ARIA2
	select BR2_PACKAGE_LIGHTTPD
	help
	  web interface to interact with aria2

	  https://github.com/ziahamza/webui-aria2
```

## package/attr/Config.in
```kconfig
config BR2_PACKAGE_ATTR
	bool "attr"
	help
	  The attr package contains utilities to administer the extended attributes on filesystem objects

	  http://download.savannah.gnu.org/releases/attr
```

## package/aufs2-util/Config.in
```kconfig
config BR2_PACKAGE_AUFS-UTIL
	bool "aufs2-util"
	help
    aufs-util is needed by the aufs union mount filesystem
    http://aufs.sourceforge.net/
```

## package/automatic/Config.in
```kconfig
config BR2_PACKAGE_AUTOMATIC
	bool "automatic"
	select BR2_PACKAGE_LIBCURL
	select BR2_PACKAGE_LIBXML2
	select BR2_PACKAGE_PCRE
	help
	 Automatic is an RSS downloader for Linux based systems, that grabs your favorite
	 torrents based on filters you specify.
	 It was designed to integrate with the popular BitTorrent client Transmission.
	 Any torrents grabbed by Automatic are directly added to Transmission, effectively
	 making it an auto-downloader. 

	 http://kylek.is-a-geek.org:31337/Automatic/
```

## package/bcrypt/Config.in
```kconfig
config BR2_PACKAGE_BCRYPT
	bool "bcrypt"
	select BR2_PACKAGE_PYTHON
	select BR2_PACKAGE_CFFI
	help
	  Python modern password hashing

	  https://github.com/pyca/bcrypt
```

## package/bonniepp/Config.in
```kconfig
config BR2_PACKAGE_BONNIEPP
	bool "bonniepp"
	help
	  Bonnie++ is a benchmark suite that is aimed at performing a number of simple tests of hard drive and file system performance.

	  http://www.coker.com.au/bonnie++
```

## package/btrfs-progs/Config.in
```kconfig
config BR2_PACKAGE_BTRFS_PROGS
	bool "btrfs-progs"
    select BR2_PACKAGE_ACL
    select BR2_PACKAGE_ATTR
    select BR2_PACKAGE_E2FSPROGS
    select BR2_PACKAGE_LZO
	select BR2_PACKAGE_ZLIB
    #select BR2_PACKAGE_UTIL_LINUX
    #select BR2_PACKAGE_UTIL_LINUX_LIBBLKID
    #select BR2_PACKAGE_UTIL_LINUX_LIBUUID
	help
	  Utility programs for Btrfs, a new copy on write (CoW) filesystem for Linux.
	
	  http://btrfs.wiki.kernel.org
```

## package/cadaver/Config.in
```kconfig
config BR2_PACKAGE_CADAVER
	bool "cadaver"
	select BR2_PACKAGE_NCURSES
	select BR2_PACKAGE_READLINE
	select BR2_PACKAGE_NEON
	help
	  cadaver is a command-line WebDAV client for Unix

	  https://packages.debian.org/jessie/cadaver
```

## package/cffi/Config.in
```kconfig
config BR2_PACKAGE_CFFI
	bool "cffi"
	select BR2_PACKAGE_PYTHON
	select BR2_PACKAGE_LIBFFI
	help
	  Foreign Function Interface for Python calling C code

	  http://cffi.readthedocs.io
```

## package/cheetah/Config.in
```kconfig
config BR2_PACKAGE_CHEETAH
	bool "cheetah"
	select BR2_PACKAGE_PYTHON
	help
	  Cheetah is a template engine and code generation python module

	  http://www.cheetahtemplate.org/
```

## package/cifs-utils/Config.in
```kconfig
config BR2_PACKAGE_CIFS_UTILS
	bool "cifs-utils"
	help
	  Tools for managing Linux CIFS client mounts

	  https://download.samba.org/pub/linux-cifs/cifs-utils/
```

## package/couchpotato2/Config.in
```kconfig
config BR2_PACKAGE_COUCHPOTATO2
	bool "couchpotato2"
	select BR2_PACKAGE_PYTHON
	select BR2_PACKAGE_CHEETAH
	help
	  CouchPotato searches and manages your movies

	  http://couchpota.to/
```

## package/cppunit/Config.in
```kconfig
config BR2_PACKAGE_CPPUNIT
	bool"cppunit"
	help
	  the C++ port of the famous JUnit framework for unit testing

	  http://www.freedesktop.org/wiki/Software/cppunit
```
