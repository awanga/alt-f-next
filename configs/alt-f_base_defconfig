## package/Config.in
```kconfig
menu "Package Selection for the target"

source "package/busybox/Config.in"

comment "The minimum needed to build a uClibc development system"

if !BR2_PACKAGE_BUSYBOX_HIDE_OTHERS
source "package/bash/Config.in"
source "package/bzip2/Config.in"
source "package/coreutils/Config.in"
source "package/diffutils/Config.in"
source "package/findutils/Config.in"
endif
source "package/flex/Config.in"
if !BR2_PACKAGE_BUSYBOX_HIDE_OTHERS
source "package/gawk/Config.in"
endif
source "toolchain/gcc/Config.in.2"
if !BR2_PACKAGE_BUSYBOX_HIDE_OTHERS
source "package/grep/Config.in"
endif
source "package/make/Config.in"
if !BR2_PACKAGE_BUSYBOX_HIDE_OTHERS
source "package/patch/Config.in"
source "package/sed/Config.in"
source "package/tar/Config.in"
endif

comment "Other development stuff"
source "package/autoconf/Config.in"
source "package/automake/Config.in"
source "package/bison/Config.in"
source "toolchain/ccache/Config.in.2"
source "package/cvs/Config.in"
source "package/git/Config.in"
source "package/distcc/Config.in"
source "package/dmalloc/Config.in"
source "package/fakeroot/Config.in"
source "package/gettext/Config.in"
source "package/gmp/Config.in"
source "package/gperf/Config.in"
source "package/libtool/Config.in"
source "package/m4/Config.in"
source "package/mpfr/Config.in"
source "package/mpatrol/Config.in"
source "package/mklibs/Config.in"
source "package/oprofile/Config.in"
source "package/pkg-config/Config.in"
source "package/readline/Config.in"
source "package/tcsh/Config.in"
source "package/valgrind/Config.in"
source "package/pcre/Config.in"

comment "Other stuff"
source "package/a2ps/Config.in"
source "package/apr/Config.in"
source "package/apr-util/Config.in"
source "package/at/Config.in"
source "package/beecrypt/Config.in"
source "package/berkeleydb/Config.in"
source "package/bsdiff/Config.in"
if !BR2_PACKAGE_BUSYBOX_HIDE_OTHERS
source "package/bootutils/Config.in"
endif
source "package/cryptopp/Config.in"
source "package/cryptlib/Config.in"
source "package/cups/Config.in"
source "package/customize/Config.in"
if !BR2_PACKAGE_BUSYBOX_HIDE_OTHERS
source "package/dash/Config.in"
endif
source "package/enchant/Config.in"
source "package/file/Config.in"
source "package/foomatic-db/Config.in"
source "package/foomatic-filters/Config.in"
source "package/gamin/Config.in"
source "package/groff/Config.in"
source "package/icu/Config.in"
source "package/kexec/Config.in"
if !BR2_PACKAGE_BUSYBOX_HIDE_OTHERS
source "package/less/Config.in"
endif
source "package/libavl/Config.in"
source "package/libbsd/Config.in"
source "package/libconfig/Config.in"
source "package/libconfuse/Config.in"
source "package/libdaemon/Config.in"
source "package/libelf/Config.in"
source "package/libevent/Config.in"
source "package/libevent2/Config.in"
source "package/libffi/Config.in"
source "package/libfloat/Config.in"
source "package/libgcrypt/Config.in"
source "package/libgpg-error/Config.in"
source "package/libiconv/Config.in"
source "package/libidn/Config.in"
source "package/liblockfile/Config.in"
source "package/libmcrypt/Config.in"
source "package/liboil/Config.in"
source "package/libpar2/Config.in"
source "package/libsigcpp/Config.in"
source "package/libsodium/Config.in"
source "package/libsysfs/Config.in"
source "package/libunistring/Config.in"
source "package/lockfile-progs/Config.in"
source "package/logrotate/Config.in"
source "package/lsof/Config.in"
source "package/ltp-testsuite/Config.in"
source "package/ltrace/Config.in"
source "package/mc/Config.in"
source "package/memstat/Config.in"
if !BR2_PACKAGE_BUSYBOX_HIDE_OTHERS
source "package/module-init-tools/Config.in"
source "package/modutils/Config.in"
endif
source "package/ng-spice-rework/Config.in"
source "package/par2cmdline/Config.in"
source "package/popt/Config.in"
if !BR2_PACKAGE_BUSYBOX_HIDE_OTHERS
source "package/procps/Config.in"
source "package/procps-ng/Config.in"
endif
if !BR2_PACKAGE_BUSYBOX_HIDE_OTHERS
source "package/psmisc/Config.in"
endif
source "package/rsnapshot/Config.in"
source "package/screen/Config.in"
source "package/shared-mime-info/Config.in"
source "package/startup-notification/Config.in"
source "package/strace/Config.in"
source "package/sudo/Config.in"
if !BR2_PACKAGE_BUSYBOX_HIDE_OTHERS
source "package/sysklogd/Config.in"
# busybox has init and the runit stuff
source "package/sysvinit/Config.in"
source "package/texinfo/Config.in"
source "package/util-linux/Config.in"
source "package/which/Config.in"
endif

source "package/database/Config.in"

if !BR2_PACKAGE_BUSYBOX_HIDE_OTHERS
# busybox has an editor

# text editors
source "package/editors/Config.in"

endif

menu "Networking"

comment "Networking applications"
source "package/amule/Config.in"
source "package/aria2/Config.in"
source "package/aria2web/Config.in"
source "package/argus/Config.in"
source "package/automatic/Config.in"
source "package/avahi/Config.in"
source "package/axel/Config.in"
if !BR2_PACKAGE_BUSYBOX_HIDE_OTHERS
source "package/boa/Config.in"
endif
source "package/bind/Config.in"
source "package/bmon/Config.in"
source "package/bridge-utils/Config.in"
source "package/cadaver/Config.in"
source "package/couchpotato/Config.in"
source "package/couchpotato2/Config.in"
source "package/ctorrent/Config.in"
if !BR2_PACKAGE_BUSYBOX_HIDE_OTHERS
source "package/dhcp/Config.in"
endif
source "package/cifs-utils/Config.in"
source "package/davfs2/Config.in"
source "package/dnsmasq/Config.in"
source "package/dropbear/Config.in"
source "package/esmtp/Config.in"
source "package/ethtool/Config.in"
source "package/gnupg/Config.in"
source "package/haserl/Config.in"
source "package/hostap/Config.in"
source "package/ifplugd/Config.in"
#source "package/irda-utils/Config.in"
source "package/inadyn/Config.in"
source "package/inadyn-mt/Config.in"
source "package/iperf/Config.in"
source "package/iproute2/Config.in"
source "package/ipsec-tools/Config.in"
source "package/iptables/Config.in"
source "package/iptraf/Config.in"
source "package/iscsitarget/Config.in"
source "package/iw/Config.in"
source "package/kismet/Config.in"
source "package/l2tp/Config.in"
source "package/lftp/Config.in"
source "package/libcgi/Config.in"
source "package/libcgicc/Config.in"
source "package/libcurl/Config.in"
source "package/libdnet/Config.in"
source "package/libesmtp/Config.in"
source "package/libeXosip2/Config.in"
source "package/libnl/Config.in"
source "package/libosip2/Config.in"
source "package/libpcap/Config.in"
source "package/librsync/Config.in"
source "package/libsoup/Config.in"
source "package/libtirpc/Config.in"
source "package/libupnp/Config.in"
if !BR2_PACKAGE_BUSYBOX_HIDE_OTHERS
source "package/lighttpd/Config.in"
endif
source "package/links/Config.in"
source "package/lrzsz/Config.in"
source "package/mdnsresponder/Config.in"
if !BR2_PACKAGE_BUSYBOX_HIDE_OTHERS
source "package/microcom/Config.in"
endif
source "package/mii-diag/Config.in"
source "package/mrouted/Config.in"
source "package/msmtp/Config.in"
source "package/mutt/Config.in"
source "package/nbd/Config.in"
source "package/ncftp/Config.in"
source "package/neon/Config.in"
source "package/netatalk/Config.in"
source "package/netatalk2/Config.in"
if !BR2_PACKAGE_BUSYBOX_HIDE_OTHERS
source "package/netcat/Config.in"
endif
source "package/netkitbase/Config.in"
source "package/netkit-rsh/Config.in"
source "package/netkittelnet/Config.in"
source "package/netperf/Config.in"
source "package/netplug/Config.in"
source "package/netsnmp/Config.in"
source "package/netstat-nat/Config.in"
source "package/nfs-utils/Config.in"
source "package/nmap/Config.in"
source "package/ntp/Config.in"
source "package/ntp-common/Config.in"
source "package/nzbget/Config.in"
source "package/nzbgetweb/Config.in"
source "package/olsr/Config.in"
source "package/owncloud/Config.in"
source "package/openntpd/Config.in"
source "package/openssh/Config.in"
source "package/openssl/Config.in"
source "package/openvpn/Config.in"
source "package/openswan/Config.in"
source "package/polipo/Config.in"
source "package/portmap/Config.in"
source "package/pppd/Config.in"
source "package/pptpd/Config.in"
source "package/radvd/Config.in"
source "package/rp-pppoe/Config.in"
source "package/pptp/Config.in"
source "package/pptp-linux/Config.in"
source "package/proftpd/Config.in"
source "package/quagga/Config.in"
source "package/rpcbind/Config.in"
source "package/rsync/Config.in"
source "package/sabnzbd/Config.in"
source "package/samba/Config.in"
source "package/samba36/Config.in"
source "package/samba-small/Config.in"
source "package/sickbeard/Config.in"
source "package/socat/Config.in"
source "package/spawn-fcgi/Config.in"
source "package/stunnel/Config.in"
source "package/svn/Config.in"
source "package/syncthing/Config.in"
source "package/tcpdump/Config.in"
source "package/tftpd/Config.in"
if !BR2_PACKAGE_BUSYBOX_HIDE_OTHERS
source "package/thttpd/Config.in"
source "package/tinyhttpd/Config.in"
endif
source "package/tn5250/Config.in"
source "package/transmission/Config.in"
source "package/ttcp/Config.in"
source "package/tt-rss/Config.in"
#if !BR2_PACKAGE_BUSYBOX_HIDE_OTHERS
# ATTENTION! This was merged into busybox!
#source "package/udhcp/Config.in"
#endif
source "package/udpcast/Config.in"
source "package/vpnc/Config.in"
source "package/vsftpd/Config.in"
source "package/vtun/Config.in"
source "package/webif/Config.in"
if !BR2_PACKAGE_BUSYBOX_HIDE_OTHERS
source "package/wget/Config.in"
endif
source "package/wireless-tools/Config.in"
source "package/wpa-supplicant/Config.in"

endmenu

menu "Hardware handling / blockdevices and filesystem maintenance"
source "package/alt-f-utils/Config.in"
source "package/acpid/Config.in"
source "package/acl/Config.in"
source "package/attr/Config.in"
source "package/aufs2-util/Config.in"
source "package/dbus/Config.in"
source "package/dbus-glib/Config.in"
source "package/dbus-python/Config.in"
source "package/bonniepp/Config.in"
source "package/btrfs-progs/Config.in"
source "package/cryptodev/Config.in"
source "package/cryptsetup/Config.in"
source "package/devio/Config.in"
source "package/devmem2/Config.in"
source "package/dmraid/Config.in"
source "package/dosfstools/Config.in"
source "package/e2fsprogs/Config.in"
source "package/eeprog/Config.in"
source "package/fconfig/Config.in"
source "package/fdupes/Config.in"
source "package/fis/Config.in"
source "package/gadgetfs-test/Config.in"
source "package/gptfdisk/Config.in"
source "package/hal/Config.in"
if !BR2_PACKAGE_BUSYBOX_HIDE_OTHERS
source "package/hdparm/Config.in"
source "package/hotplug/Config.in"
endif
source "package/hddtemp/Config.in"
source "package/hfsprogs/Config.in"
source "package/hplip/Config.in"
source "package/hwdata/Config.in"
source "package/i2c-tools/Config.in"
source "package/input-tools/Config.in"
source "package/iostat/Config.in"
source "package/kernel-modules/Config.in"
source "package/libaio/Config.in"
source "package/libfuse/Config.in"
source "package/libraw1394/Config.in"
source "package/libusb/Config.in"
source "package/libusb1/Config.in"
source "package/lm-sensors/Config.in"
source "package/lvm2/Config.in"
source "package/mdadm/Config.in"
source "package/memtester/Config.in"
source "package/mtd-utils/Config.in"
source "package/ntfs-3g/Config.in"
source "package/nuts/Config.in"
source "package/parted/Config.in"
source "package/pciutils/Config.in"
source "package/pcmcia/Config.in"
source "package/quota-tools/Config.in"
source "package/sane/Config.in"
source "package/secure-delete/Config.in"
source "package/setserial/Config.in"
if !BR2_PACKAGE_BUSYBOX_HIDE_OTHERS
# busybox has fdisk
source "package/sfdisk/Config.in"
endif
source "package/sg3_utils/Config.in"
source "package/smartmontools/Config.in"
source "package/squashfs/Config.in"
source "package/srm/Config.in"
source "package/sysstat/Config.in"
if !BR2_PACKAGE_BUSYBOX_HIDE_OTHERS
# mdev
source "package/udev/Config.in"
endif
source "package/uboot-mkimage/Config.in"
source "package/unionfs-utils/Config.in"
source "package/usbmount/Config.in"
source "package/usbutils/Config.in"
source "package/wipe/Config.in"
source "package/xfsprogs/Config.in"
endmenu

# Audio/Video support
source "package/multimedia/Config.in"

menu "Graphic libraries and applications (graphic/text)"
comment "text rendering libraries"
source "package/htop/Config.in"
source "package/ncurses/Config.in"
source "package/newt/Config.in"
source "package/slang/Config.in"

comment "text rendering applications"
source "package/dialog/Config.in"

comment "graphic libraries"
source "package/directfb/Config.in"
source "package/directfb-examples/Config.in"
source "package/fbdump/Config.in"
source "package/libgd/Config.in"
source "package/imagemagick/Config.in"
source "package/jpeg/Config.in"
source "package/libart/Config.in"
source "package/libexif/Config.in"
source "package/libpng/Config.in"
source "package/libungif/Config.in"
source "package/linux-fusion/Config.in"
source "package/lite/Config.in"
source "package/pixman/Config.in"
source "package/sawman/Config.in"
source "package/sdl/Config.in"
source "package/sdl_image/Config.in"
source "package/sdl_mixer/Config.in"
source "package/sdl_net/Config.in"
source "package/sdl_ttf/Config.in"
source "package/sdl_gfx/Config.in"
source "package/tiff/Config.in"

comment "busybox graphic applications"
comment "--> May be broken in busybox"
source "package/fbv/Config.in"
source "package/fbset/Config.in"

comment "other GUIs"
source "package/qt/Config.in"

#source "package/microwin/Config.in"

source "package/x11r7/Config.in"

comment "X libraries and helper libraries"
source "package/atk/Config.in"
source "package/cairo/Config.in"
source "package/pango/Config.in"
source "package/libdrm/Config.in"
source "package/liberation/Config.in"
source "package/libglade/Config.in"
source "package/libglib12/Config.in"
source "package/libglib2/Config.in"
source "package/libgtk12/Config.in"
source "package/libgtk2/Config.in"
source "package/gtk2-engines/Config.in"
source "package/gtk2-themes/Config.in"
source "package/libsexy/Config.in"
source "package/fltk/Config.in"
source "package/openmotif/Config.in"
source "package/fontconfig/Config.in"
source "package/freetype/Config.in"
source "package/tslib/Config.in"
source "package/webkit/Config.in"
source "package/wxwidgets/Config.in"

comment "X Window managers"
source "package/matchbox/Config.in"
source "package/metacity/Config.in"
source "package/blackbox/Config.in"

comment "X applications"
source "package/alsamixergui/Config.in"
source "package/dillo/Config.in"
source "package/docker/Config.in"
source "package/gqview/Config.in"
source "package/gmpc/Config.in"
source "package/gob2/Config.in"
source "package/gtkperf/Config.in"
source "package/leafpad/Config.in"
source "package/midori/Config.in"
source "package/pcmanfm/Config.in"
source "package/rdesktop/Config.in"
source "package/rxvt/Config.in"
source "package/sylpheed/Config.in"
source "package/synergy/Config.in"
source "package/torsmo/Config.in"
source "package/x11vnc/Config.in"
source "package/xpdf/Config.in"
source "package/xstroke/Config.in"
source "package/xvkbd/Config.in"
endmenu

menu "Compressors / decompressors"

if !BR2_PACKAGE_BUSYBOX_HIDE_OTHERS
source "package/gzip/Config.in"
endif
source "package/lzo/Config.in"
source "package/lzop/Config.in"
source "package/lzma/Config.in"
source "package/p7zip/Config.in"
source "package/unrar/Config.in"
source "package/xz/Config.in"
source "package/zlib/Config.in"
endmenu

menu "Package managers"

source "package/ipkg/Config.in"
source "package/ipkg-utils/Config.in"
source "package/portage/Config.in"
if !BR2_PACKAGE_BUSYBOX_HIDE_OTHERS
source "package/rpm/Config.in"
endif
endmenu

menu "Interpreter languages / Scripting"

source "package/bcrypt/Config.in"
source "package/cffi/Config.in"
source "package/cheetah/Config.in"
source "package/cryptography/Config.in"
source "package/duplicity/Config.in"
source "package/gs/Config.in"
source "package/libantlr/Config.in"
source "package/lua/Config.in"
source "package/microperl/Config.in"
source "package/ocaml/Config.in"
source "package/perl/Config.in"
source "package/php/Config.in"
source "package/python/Config.in"
source "package/pycrypto/Config.in"
source "package/pycurl/Config.in"
source "package/pyload/Config.in"
source "package/pynacl/Config.in"
source "package/pyopenssl/Config.in"
source "package/ruby/Config.in"
source "package/tcl/Config.in"
source "package/yenc/Config.in"

endmenu

menu "XML handling"

source "package/expat/Config.in"
source "package/ezxml/Config.in"
source "package/libxml2/Config.in"
source "package/libxslt/Config.in"
source "package/mxml/Config.in"
source "package/xerces/Config.in"
endmenu

# java support
source "package/java/Config.in"

# various games packages
source "package/games/Config.in"

endmenu
```
